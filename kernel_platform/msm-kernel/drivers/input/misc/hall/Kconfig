## kernel_platform/msm-kernel/drivers/samsung/debug/qcom/Kconfig
```kconfig
source "drivers/samsung/debug/qcom/debug/Kconfig"
source "drivers/samsung/debug/qcom/reboot_cmd/Kconfig"
source "drivers/samsung/debug/qcom/dbg_partition/Kconfig"
source "drivers/samsung/debug/qcom/reboot_reason/Kconfig"
source "drivers/samsung/debug/qcom/upload_cause/Kconfig"
source "drivers/samsung/debug/qcom/logger/Kconfig"
source "drivers/samsung/debug/qcom/soc_id/Kconfig"
source "drivers/samsung/debug/qcom/wdt_core/Kconfig"
source "drivers/samsung/debug/qcom/summary/Kconfig"
source "drivers/samsung/debug/qcom/user_reset/Kconfig"
source "drivers/samsung/debug/qcom/smem/Kconfig"
source "drivers/samsung/debug/qcom/hw_param/Kconfig"
source "drivers/samsung/debug/qcom/rst_exinfo/Kconfig"
source "drivers/samsung/debug/qcom/mock/Kconfig"
```

## kernel_platform/msm-kernel/drivers/samsung/debug/qcom/dbg_partition/Kconfig
```kconfig
config SEC_QC_DEBUG_PARTITION
	tristate "SEC Debug Partition for Qualcomm SoC based models"
	help
	  TODO: help is not ready.

config SEC_QC_DBG_PARTITION_TEST_FOR_ON_DEVICE
	tristate "KUnit test for sec_qc_dbg_partition_test"
	depends on KUNIT
	depends on SEC_QC_DEBUG_PARTITION
	help
	  TODO: Describe config fully.
	  If you run this test driver on device, SHOULD set this config as 'm' to build test driver modulraly.

config SEC_QC_DBG_PARTITION_TEST_FOR_ONLY_UML
	tristate "KUnit test for sec_qc_dbg_partition_test"
	depends on KUNIT
	depends on UML
	depends on SEC_QC_DEBUG_PARTITION
	help
	  TODO: Describe config fully.
	  This CONFIG is recommended to set to y.
```

## kernel_platform/msm-kernel/drivers/samsung/debug/qcom/logger/Kconfig
```kconfig
config SEC_QC_LOGGER
	tristate "SEC Logger for Qualcomm based devices"
	depends on SEC_DEBUG_REGION
	help
	  TODO: help is not ready.
```
