## kernel_platform/msm-kernel/drivers/input/misc/hall/Kconfig
```kconfig
# SPDX-License-Identifier: GPL-2.0-only
#
# HALL IC driver configuration
#

config INPUT_HALL_IC
	tristate "Enable HALL IC"
	default n
	help
	  Enable Hall IC Feature

config HALL_NOTIFIER
	tristate "use hall ic notifier"
	depends on INPUT_HALL_IC
	default n
	help
	  Enable notifier functions to notify hall ic status

config HALL_LOGICAL
	tristate "use logical hall ic"
	depends on INPUT_HALL_IC
	default n
	help
	  Enable logical hall ic feature
	  It is used for pogo keyboard usually

config HALL_DUMP_KEY_MODE
	tristate "use hall dump key"
	default n
	help
	  Enable hall dump key
```

## kernel_platform/msm-kernel/drivers/input/sec_input/wacom/Kconfig
```kconfig
#
# Wacom configuration
#

config INPUT_WACOM_WEZ02
	tristate "Wacom penabled i2c touchscreen"
	depends on I2C
	help
	  Say Y here if you have an Wacom penabled i2c touchscreen
	  connected to your system.
	  If unsure, say N.
```

## kernel_platform/msm-kernel/drivers/knox/hdm/Kconfig
```kconfig
# @file Kconfig
# @brief Kconfig for HDM driver
# Copyright (c) 2019, Samsung Electronics Corporation. All rights reserved.
#
# This program is free software; you can redistribute it and/or modify
# it under the terms of the GNU General Public License version 2 and
# only version 2 as published by the Free Software Foundation.
#
# This program is distributed in the hope that it will be useful,
# but WITHOUT ANY WARRANTY; without even the implied warranty of
# MERCHANTABILITY or FITNESS FOR A PARTICULAR PURPOSE.  See the
# GNU General Public License for more details.

config HDM
	tristate "HDM feature enable"
	depends on !ARCH_QTI_VM
	help
	HDM TLC uses the HDM driver to trigger the hypervisor.
	And it is responsible for receiving and processing bootconfig related to HDM.

config HDM_QCOM
	bool "HDM QCOM device"
	default n
	help
	This enables the HDM for QCOM device

config HDM_EXYNOS
	bool "HDM EXYNOS device"
	default n
	help
	This enables the HDM for EXYNOS device

config HDM_MTK
	bool "HDM MTK device"
	default n
	help
	This enables the HDM for MTK device
```

## kernel_platform/msm-kernel/drivers/knox/ngksm/Kconfig
```kconfig
# @file Kconfig
# @brief Kconfig for Next Generation Knox Security Driver
# Copyright (c) 2019, Samsung Electronics Corporation. All rights reserved.
#
# This program is free software; you can redistribute it and/or modify
# it under the terms of the GNU General Public License version 2 and
# only version 2 as published by the Free Software Foundation.
#
# This program is distributed in the hope that it will be useful,
# but WITHOUT ANY WARRANTY; without even the implied warranty of
# MERCHANTABILITY or FITNESS FOR A PARTICULAR PURPOSE.  See the
# GNU General Public License for more details.

config NGKSM
	tristate "Next Generation Knox Security Monitor feature enable"
	help
	This enables knox securty monitor driver

config NGKPAD
	tristate "Next Generation Knox Peripheral Access Detection feature enable"
	depends on NGKSM
	help
	This enables Next Generation Knox Peripheral Access Detection

config NGKSM_QCOM
	bool "NGKSM QCOM device"
	default n
	help
	This enables the NGKSM for QCOM device

config NGKSM_EXYNOS
	bool "NGKSM EXYNOS device"
	default n
	help
	This enables the NGKSM for EXYNOS device

config NGKSM_MTK
	bool "NGKSM MTK device"
	default n
	help
	This enables the NGKSM for MTK device
```

## kernel_platform/msm-kernel/drivers/mfd/maxim/Kconfig
```kconfig
config MFD_MAX77775
	tristate "Maxim Semiconductor MAX77775 PMIC Support"
	depends on I2C=y
	select MFD_CORE
	help
	  Say yes here to support for Maxim Semiconductor MAX77775.
	  This is a Power Management IC with Charger, safe LDOs,
	  and Haptic controls on chip.
	  This driver provides common support for accessing the device;
	  additional drivers

config MAX77775_ABC_IFPMIC_EVENT
	bool "Using EVENT SENDING TO ABC MODULE"
	depends on I2C=y
	default n
	help
	  If you say yes here you will not get support for the sending event to abc module.
```

## kernel_platform/msm-kernel/drivers/misc/drb/Kconfig
```kconfig
#
# Dev-Ril-Bridge driver
#

config DEV_RIL_BRIDGE
	tristate "Support a bridge between device and RIL"
	default n
```

## kernel_platform/msm-kernel/drivers/mstdrv/Kconfig
```kconfig
# @file Kconfig
# @brief Kconfig for MST drivers
# Copyright (c) 2015-2019, Samsung Electronics Corporation. All rights reserved.
#
# This program is free software; you can redistribute it and/or modify
# it under the terms of the GNU General Public License version 2 and
# only version 2 as published by the Free Software Foundation.
#
# This program is distributed in the hope that it will be useful,
# but WITHOUT ANY WARRANTY; without even the implied warranty of
# MERCHANTABILITY or FITNESS FOR A PARTICULAR PURPOSE.  See the
# GNU General Public License for more details. 

config MST_LDO
	tristate "MST LDO kernel driver"
	default n
	help
	This enables the MST LDO kernel driver

config MST_ARCH_EXYNOS
	bool "MST S.LSI Architecture"
	default n
	help
	This enables the MST S.LSI Architecture

config MST_ARCH_QCOM
	bool "MST QCOM Architecture"
	default n
	help
	This enables the MST QCOM Architecture

config MST_ARCH_MTK
	bool "MST MediaTek Architecture"
	default n
	help
	This enables the MST MediaTek Architecture

config MST_V2
	bool "MST Version 2"
	default n
	help
	This enables the MST V2 Code

config MST_SUPPORT_GPIO
	bool "MST uses support gpio"
	default n
	help
	This enables support gpio check code

config MST_NONSECURE
	bool "MST before TrustZone bringup"
	default n
	help
	This enables the MST operation in Normal kernel

config MST_IF_PMIC
	bool "MST is used in IF PMIC"
	default n
	help
	This enables the MST IF PMIC function

config MFC_CHARGER
	bool "MFC IC using model"
	default n
	help
	This enables the MFC IC sysfs node

config MST_PCR
	bool "support for MST PCR mode"
	default n
	depends on MFC_CHARGER
	help
	  Say Y here to enable
	  support for MST PCR mode
	  It is for model using MFC IC
	  Some MFC ICs support PCR mode.

config MST_VOUT_SETTING
	bool "setting vout for MST"
	default n
	depends on MFC_CHARGER
	help
	  Say Y here to enable
	  support for setting vout
	  It is for model using MFC IC
	  Some MFC ICs support PCR mode.

config MST_TEEGRIS
	bool "MST running on TEEGRIS"
	default n
	help
	This enables the MST TEEGRIS function

config MST_DUMMY_DRV
	bool "MST DUMMY DRVIER for MTK"
	default n
	help
	  Say y here to enable
	  This config is for mtk devices
	  It can distinguish the regions
	  This enables the MST DUMMY DRIVER
```

## kernel_platform/msm-kernel/drivers/nfc/snvm/Kconfig
```kconfig
#
# SEC STAR platform devices
#

config STAR_MEMORY_LEAK
	bool "memory leak test in sec-star"
	help
	  memory leak test in sec-star.
	  All allocated memory are listed in array.

config STAR_K250A_LEGO
	tristate "S.LSI k250a driver"
	default n
	help
	  S.LSI k250a driver except ISO7816 protocol layer
	  This driver provides support for S.LSI k250a product.

config SEC_SNVM_WAKELOCK_METHOD
        int "snvm wakelock method"
        default 0
        help
          Different functions must be used depending on the kernel version
          for wakelock initialization.
          0 - auto selection
          1 - wakeup_source_init
          2 - wakeup_source_register

config SEC_SNVM_PLATFORM_DRV
	bool "snvm platform driver"
	default n
	help
	  make snvm driver to platfrom driver
	  disable i2c node

config SEC_SNVM_I2C_CLOCK_CONTROL
	bool "snvm i2c clock control"
	default n
	help
	  control the I2C clocks
	  now only for MTK project
```

## kernel_platform/msm-kernel/drivers/regulator/dio8018/Kconfig
```kconfig
if REGULATOR

config REGULATOR_DIO8018
	tristate "DIOO DIO8018 PMIC"
	depends on I2C
	help
	  This driver controls a DIOO DIO8018 PMIC
	  via I2C bus.

config REGULATOR_DIO8018_RECOVERY
	bool "DIOO DIO8018 PMIC Recovery"
	help
	  This is a necessary property in situations
	  where the source power of PMIC may be interrupted

config DIO8018_TEST_FOR_ON_DEVICE
	tristate "KUnit test for dio8018_test"
	depends on SEC_KUNIT
	depends on REGULATOR_DIO8018
	help
	  TODO: Describe config fully.
	  If you run this test driver on device, SHOULD set this config as 'm' to build test driver modulraly.

config DIO8018_TEST_FOR_ONLY_UML
	tristate "KUnit test for dio8018_test"
	depends on SEC_KUNIT
	depends on UML
	depends on REGULATOR_DIO8018
	help
	  TODO: Describe config fully.
	  This CONFIG is recommended to set to y.
	  
endif
```

## kernel_platform/msm-kernel/drivers/regulator/pmic_class/Kconfig
```kconfig
if REGULATOR

config DRV_SAMSUNG_PMIC
	tristate "Samsung PMIC sysfs system"
	help
	 This driver supports a Samsung PMIC sysfs.

endif
```

## kernel_platform/msm-kernel/drivers/regulator/s2mpb03/Kconfig
```kconfig
if REGULATOR

config REGULATOR_S2MPB03
	tristate "Samsung S2MPB03 regulator"
	depends on I2C
	help
	 This driver controls a Samsung S2MPB03 regulator
	 via I2C bus.
endif


config S2MPB03_TEST_FOR_ON_DEVICE
	tristate "KUnit test for s2mpb03_test"
	depends on SEC_KUNIT
	depends on REGULATOR_S2MPB03
	help
	  TODO: Describe config fully.
	  If you run this test driver on device, SHOULD set this config as 'm' to build test driver modulraly.

config S2MPB03_TEST_FOR_ONLY_UML
	tristate "KUnit test for s2mpb03_test"
	depends on SEC_KUNIT
	depends on UML
	depends on REGULATOR_S2MPB03
	help
	  TODO: Describe config fully.
	  This CONFIG is recommended to set to y.
```

## kernel_platform/msm-kernel/drivers/samsung/bsp/blk_helper/Kconfig
```kconfig
config SEC_BLK_HELPER
	tristate "Samsung sec block-dev helper facilities"
	help
	  This driver is a collection of helper functions to read/write block devices.

config SEC_BLK_HELPER_TEST_FOR_ON_DEVICE
	tristate "KUnit test for SEC_BLK_HELPER_test"
	depends on KUNIT
	depends on SEC_BLK_HELPER
	help
	  TODO: Describe config fully.
	  If you run this test driver on device, SHOULD set this config as 'm' to build test driver modulraly.

config SEC_BLK_HELPER_TEST_FOR_ONLY_UML
	tristate "KUnit test for SEC_BLK_HELPER_test"
	depends on KUNIT
	depends on UML
	depends on SEC_BLK_HELPER
	help
	  TODO: Describe config fully.
	  This CONFIG is recommended to set to y.
```

## kernel_platform/msm-kernel/drivers/samsung/bsp/key_notifier/Kconfig
```kconfig
config SEC_KEY_NOTIFIER
	tristate "SEC Atomic keyboard notifierr"
	help
	  TODO: help is not ready.
```

## kernel_platform/msm-kernel/drivers/samsung/bsp/param/Kconfig
```kconfig
config SEC_PARAM
	tristate "Samsung PARAM driver"
	help
	  TODO: help is not ready.
```

## kernel_platform/msm-kernel/drivers/samsung/bsp/reloc_gpio/Kconfig
```kconfig
config SEC_RELOC_GPIO
	tristate "Samsung Legacy-Style Relocated GPIO Interface"
	default m if SEC_CLASS=m
	default y if SEC_CLASS=y
	help
	  TODO: help is not ready.

config SEC_RELOC_GPIO_EN
	bool "Samsung Legacy-Style Relocated GPIO Interface for Factory Mode"
	depends on SEC_RELOC_GPIO
	default y if SEC_FACTORY
	default n
	help
	  TODO: help is not ready.

config SEC_RELOC_GPIO_TEST_FOR_ON_DEVICE
	tristate "KUnit test for sec_reloc_gpio_test"
	depends on KUNIT
	depends on SEC_RELOC_GPIO
	help
	  TODO: Describe config fully.
	  If you run this test driver on device, SHOULD set this config as 'm' to build test driver modulraly.

config SEC_RELOC_GPIO_TEST_FOR_ONLY_UML
	tristate "KUnit test for sec_reloc_gpio_test"
	depends on KUNIT
	depends on UML
	depends on SEC_RELOC_GPIO
	help
	  TODO: Describe config fully.
	  This CONFIG is recommended to set to y.
```

## kernel_platform/msm-kernel/drivers/samsung/debug/Kconfig
```kconfig
source "drivers/samsung/debug/common/Kconfig"
source "drivers/samsung/debug/boot_stat/Kconfig"
source "drivers/samsung/debug/log_buf/Kconfig"
source "drivers/samsung/debug/pmsg/Kconfig"
source "drivers/samsung/debug/reboot_cmd/Kconfig"
source "drivers/samsung/debug/upload_cause/Kconfig"
source "drivers/samsung/debug/crashkey/Kconfig"
source "drivers/samsung/debug/crashkey_long/Kconfig"
source "drivers/samsung/debug/debug_region/Kconfig"
source "drivers/samsung/debug/rdx_bootdev/Kconfig"

# TODO: architecture specific drivers at here
source "drivers/samsung/debug/arm64/Kconfig"
source "drivers/samsung/debug/riscv64/Kconfig"

# TODO: soc specific drivers at here
source "drivers/samsung/debug/qcom/Kconfig"
```

## kernel_platform/msm-kernel/drivers/samsung/debug/arm64/fsimd_debug/Kconfig
```kconfig
config SEC_ARM64_FSIMD_DEBUG
	tristate "SEC Detecting undesired NEON usage in kernel"
	depends on ARM64 && ANDROID_VENDOR_HOOKS
	help
	  TODO: help is not ready.
```

## kernel_platform/msm-kernel/drivers/samsung/debug/common/Kconfig
```kconfig
menuconfig SEC_DEBUG
	tristate "SEC TN Debugging Features"
	help
	  TODO: help is not ready.

config SEC_FORCE_ERR
	bool "SEC Generating force errors"
	default y if SEC_FACTORY
	depends on SEC_DEBUG
	help
	  TODO: help is not ready.
```

## kernel_platform/msm-kernel/drivers/samsung/debug/crashkey/Kconfig
```kconfig
config SEC_CRASHKEY
	tristate "SEC Force key crash driver"
	depends on SEC_KEY_NOTIFIER
	help
	  TODO: help is not ready.

config SEC_CRASHKEY_TEST_FOR_ON_DEVICE
	tristate "KUnit test for sec_crashkey_test"
	depends on KUNIT
	depends on SEC_CRASHKEY
	help
	  TODO: Describe config fully.
	  If you run this test driver on device, SHOULD set this config as 'm' to build test driver modulraly.

config SEC_CRASHKEY_TEST_FOR_ONLY_UML
	tristate "KUnit test for sec_crashkey_test"
	depends on KUNIT
	depends on UML
	depends on SEC_CRASHKEY
	help
	  TODO: Describe config fully.
	  This CONFIG is recommended to set to y.
```

## kernel_platform/msm-kernel/drivers/samsung/debug/crashkey_long/Kconfig
```kconfig
config SEC_CRASHKEY_LONG
	tristate "SEC Long key reset driver"
	depends on SEC_KEY_NOTIFIER
	help
	  TODO: help is not ready.

config SEC_CRASHKEY_LONG_TEST_FOR_ON_DEVICE
	tristate "KUnit test for sec_crashkey_long_test"
	depends on KUNIT
	depends on SEC_CRASHKEY_LONG
	help
	  TODO: Describe config fully.
	  If you run this test driver on device, SHOULD set this config as 'm' to build test driver modulraly.

config SEC_CRASHKEY_LONG_TEST_FOR_ONLY_UML
	tristate "KUnit test for sec_crashkey_long_test"
	depends on KUNIT
	depends on UML
	depends on SEC_CRASHKEY_LONG
	help
	  TODO: Describe config fully.
	  This CONFIG is recommended to set to y.
```

## kernel_platform/msm-kernel/drivers/samsung/debug/log_buf/Kconfig
```kconfig
config SEC_LOG_BUF
	tristate "SEC Kernel Log Buffer"
	help
	  TODO: help is not ready.

config SEC_LOG_BUF_USING_TP_CONSOLE
	bool "SEC Kernel Log Buffer - Trace Console Back-End"
	depends on SEC_LOG_BUF
	default n
	help
	  TODO: help is not ready.

config SEC_LOG_BUF_USING_KPROBE
	bool "SEC Kernel Log Buffer - Kprobe Back-End"
	depends on SEC_LOG_BUF
	default n
	help
	  TODO: help is not ready.

config SEC_LOG_BUF_USING_VH_LOGBUF
	bool "SEC Kernel Log Buffer - Android Vendor-Hook Back-End"
	depends on SEC_LOG_BUF
	default n
	help
	  TODO: help is not ready.
```

## kernel_platform/msm-kernel/drivers/samsung/debug/pmsg/Kconfig
```kconfig
config SEC_PMSG
	tristate "PSTORE backend for saving android platform log"
	help
	  TODO: help is not ready.

config SEC_PMSG_TEST_FOR_ON_DEVICE
	tristate "KUnit test for sec_pmsg_test"
	depends on KUNIT
	depends on SEC_PMSG
	help
	  TODO: Describe config fully.
	  If you run this test driver on device, SHOULD set this config as 'm' to build test driver modulraly.

config SEC_PMSG_TEST_FOR_ONLY_UML
	tristate "KUnit test for sec_pmsg_test"
	depends on KUNIT
	depends on UML
	depends on SEC_PMSG
	help
	  TODO: Describe config fully.
	  This CONFIG is recommended to set to y.
```
