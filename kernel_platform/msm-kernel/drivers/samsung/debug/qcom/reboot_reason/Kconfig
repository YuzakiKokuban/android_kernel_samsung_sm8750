## kernel_platform/msm-kernel/drivers/samsung/debug/qcom/reboot_reason/Kconfig
```kconfig
config SEC_QC_QCOM_REBOOT_REASON
	tristate "SEC Reboot Commands - Concrete writer using qcom-reboot-reason"
	depends on SEC_QC_RBCMD && POWER_RESET_QCOM_DOWNLOAD_MODE && POWER_RESET_QCOM_REBOOT_REASON
	help
	  TODO: help is not ready.
```

## kernel_platform/msm-kernel/drivers/samsung/debug/qcom/rst_exinfo/Kconfig
```kconfig
config SEC_QC_RST_EXINFO
	tristate "SEC Reset extra info for Qualcomm based devices"
	help
	  TODO: help is not ready.

config SEC_QC_RST_EXINFO_TEST_FOR_ON_DEVICE
	tristate "KUnit test for sec_qc_rst_exinfo_test"
	depends on KUNIT
	depends on SEC_QC_RST_EXINFO
	help
	  TODO: Describe config fully.
	  If you run this test driver on device, SHOULD set this config as 'm' to build test driver modulraly.

config SEC_QC_RST_EXINFO_TEST_FOR_ONLY_UML
	tristate "KUnit test for sec_qc_rst_exinfo_test"
	depends on KUNIT
	depends on UML
	depends on SEC_QC_RST_EXINFO
	help
	  TODO: Describe config fully.
	  This CONFIG is recommended to set to y.
```

## kernel_platform/msm-kernel/drivers/samsung/debug/qcom/smem/Kconfig
```kconfig
config SEC_QC_SMEM
	tristate "SEC SMEM for Qualcomm based devices"
	help
	  TODO: help is not ready.
```

## kernel_platform/msm-kernel/drivers/samsung/debug/qcom/soc_id/Kconfig
```kconfig
config SEC_QC_SOC_ID
	tristate "SEC SoC ID for Qualcomm SoC based models"
	help
	  TODO: help is not ready.

config SEC_QC_SOC_ID_EN
	bool "SEC SoC ID for Qualcomm SoC based models for Factory Mode"
	depends on SEC_QC_SOC_ID
	default y if SEC_FACTORY
	default n
	help
	  TODO: help is not ready.

config SEC_QC_SOC_ID_TEST_FOR_ON_DEVICE
	tristate "KUnit test for sec_qc_soc_id_test"
	depends on KUNIT
	depends on SEC_QC_SOC_ID
	help
	  TODO: Describe config fully.
	  If you run this test driver on device, SHOULD set this config as 'm' to build test driver modulraly.

config SEC_QC_SOC_ID_TEST_FOR_ONLY_UML
	tristate "KUnit test for sec_qc_soc_id_test"
	depends on KUNIT
	depends on UML
	depends on SEC_QC_SOC_ID
	help
	  TODO: Describe config fully.
	  This CONFIG is recommended to set to y.
```

## kernel_platform/msm-kernel/drivers/samsung/debug/qcom/summary/Kconfig
```kconfig
config SEC_QC_SUMMARY
	tristate "SEC Debug Summary for Qualcomm SoC based models"
	help
	  TODO: help is not ready.
```

## kernel_platform/msm-kernel/drivers/samsung/debug/reboot_cmd/Kconfig
```kconfig
config SEC_REBOOT_CMD
	tristate "SEC Reboot Command Iterator"
	help
	  TODO: help is not ready.

config SEC_REBOOT_CMD_TEST_FOR_ON_DEVICE
	tristate "KUnit test for sec_reboot_cmd_test"
	depends on KUNIT
	depends on SEC_REBOOT_CMD
	help
	  TODO: Describe config fully.
	  If you run this test driver on device, SHOULD set this config as 'm' to build test driver modulraly.

config SEC_REBOOT_CMD_TEST_FOR_ONLY_UML
	tristate "KUnit test for sec_reboot_cmd_test"
	depends on KUNIT
	depends on UML
	depends on SEC_REBOOT_CMD
	help
	  TODO: Describe config fully.
	  This CONFIG is recommended to set to y.
```

## kernel_platform/msm-kernel/drivers/samsung/debug/riscv64/Kconfig
```kconfig
source "drivers/samsung/debug/riscv64/ap_context/Kconfig"
source "drivers/samsung/debug/riscv64/debug/Kconfig"
```

## kernel_platform/msm-kernel/drivers/samsung/debug/riscv64/ap_context/Kconfig
```kconfig
config SEC_RISCV64_AP_CONTEXT
	tristate "SEC AP CORE/CSR context snaphot (RISC-V)"
	depends on SEC_DEBUG_REGION && RISCV && 64BIT && ANDROID_VENDOR_HOOKS
	help
	  TODO: help is not ready.
```

## kernel_platform/msm-kernel/drivers/samsung/debug/upload_cause/Kconfig
```kconfig
config SEC_UPLOAD_CAUSE
	tristate "SEC Panic Notifier Updating Upload Cause"
	help
	  TODO: help is not ready.

config SEC_UPLOAD_CAUSE_TEST_FOR_ON_DEVICE
	tristate "KUnit test for sec_upload_cause_test"
	depends on KUNIT
	depends on SEC_UPLOAD_CAUSE
	help
	  TODO: Describe config fully.
	  If you run this test driver on device, SHOULD set this config as 'm' to build test driver modulraly.

config SEC_UPLOAD_CAUSE_TEST_FOR_ONLY_UML
	tristate "KUnit test for sec_upload_cause_test"
	depends on KUNIT
	depends on UML
	depends on SEC_UPLOAD_CAUSE
	help
	  TODO: Describe config fully.
	  This CONFIG is recommended to set to y.
```

## kernel_platform/msm-kernel/drivers/samsung/ipc/Kconfig
```kconfig
config SEC_IPC_TIANTONG
    tristate "Tiantong driver"
    help
      TODO: help is not ready
```

## kernel_platform/msm-kernel/drivers/samsung/pm/sec_thermistor/Kconfig
```kconfig
config SEC_PM_THERMISTOR
    tristate "SEC Thermistor support"
    depends on SEC_PM && IIO
    default n
    help
      This driver supports SEC Thermistor sensor readinga nd its
      interpretation. This driver uses the industrial I/O subsystem
      and need adc-termperature mapping table for conversion.
```

## kernel_platform/msm-kernel/drivers/samsung/power/Kconfig
```kconfig
config SEC_PM
	bool "Samsung PowerManagement Feature"
	default y
	help
	  Samsung PowerManagement Feature.

config SEC_EXT_THERMAL_MONITOR
	tristate "Samsung external thermal monitor"
	help
	  This enables external thermal monitor to get hint whether if there's
	  external cause or not.

config SEC_PM_LOG
	tristate "Samsung Power/Thermal Log driver"
	help
	  TODO: help is not ready.

config SEC_PM_REGULATOR
	tristate "Enable Samsung Mobile Regulator control driver"
	default n
	depends on SEC_PM && REGULATOR
	help
	  This option enables Samsung Mobile Power regulator control and debugging support.
```

## kernel_platform/msm-kernel/drivers/sec_panel_notifier_v2/Kconfig
```kconfig
#
# samsung panel notifier
#

config SEC_PANEL_NOTIFIER_V2
	tristate "samsung panel notifier"
	help
	  Samsung panel notifier.

config SEC_PANEL_NOTIFIER_V2_TEST_FOR_ON_DEVICE
	tristate "KUnit test for sec_panel_notifier_v2_test"
	depends on KUNIT
	depends on SEC_PANEL_NOTIFIER_V2
	help
	  TODO: Describe config fully.
	  If you run this test driver on device, SHOULD set this config as 'm' to build test driver modulraly.

config SEC_PANEL_NOTIFIER_V2_TEST_FOR_ONLY_UML
	tristate "KUnit test for sec_panel_notifier_v2_test"
	depends on KUNIT
	depends on UML
	depends on SEC_PANEL_NOTIFIER_V2
	help
	  TODO: Describe config fully.
	  This CONFIG is recommended to set to y.
```

## kernel_platform/msm-kernel/drivers/sensors/Kconfig
```kconfig
# SPDX-License-Identifier: GPL-2.0-only

config SENSORS
	tristate "Sensors Class Support"
	help
	  This option enables the sensor sysfs class in /sys/class/sensors.
	  You'll need this to do anything useful with sensors. If unsure, say N.
```

## kernel_platform/msm-kernel/drivers/staging/android/switch/Kconfig
```kconfig
menuconfig ANDROID_SWITCH
	tristate "Android Switch class support"
	help
	  Say Y here to enable Android switch class support.
	  This allows monitoring switches by userspace via sysfs and uevent.

config ANDROID_SWITCH_GPIO
	tristate "Android GPIO Switch support"
	help
	  Say Y here to enable GPIO based switch support.
```

## kernel_platform/msm-kernel/drivers/sti/common/Kconfig
```kconfig
comment "Samsung STI Options"
config SEC_STI
	tristate "Samsung STI(System Test Infra)"
	default n
	help
		Config to support Samsung STI(System Test Infra) solutions.
		There are many sub configs to support
		ABC driver, ABC hub driver, LABO driver and so on.
		All sub configs depends on config SEC_STI.
```

## kernel_platform/msm-kernel/drivers/usb/common/vbus_notifier/Kconfig
```kconfig
comment "USB common vbus notifier configs"

config VBUS_NOTIFIER
	tristate "VBUS notifier support"
	default n
	help
	  If you say yes here you will get support for
	  the VBUS status change notification.
```

## kernel_platform/msm-kernel/drivers/vibrator/common/inputff/Kconfig
```kconfig
config SEC_VIBRATOR_INPUTFF
	tristate "sec vibrator inputff"
	default n
	help
	  If you say yes here you will get support for the
	  sec vibrator inputff driver

config SEC_VIBRATOR_INPUTFF_TEST
        bool "KUnit test for sec_vibrator_inputff_test"
        depends on SEC_KUNIT
        help
          This driver is for inputff test driver
		  sec vibrator kunit test
		  If you want to add some functions,
		  Please make the test case.

config SEC_VIB_FOLD_MODEL
	bool "get support for folder/flip status"
	default n
	help
	  If you enable this feature,
	  you will get event for folder/flip status
	  through event_cmd sysfs

config VIB_STORE_LE_PARAM
	bool "To store the le param into NV preferably on SEC PARAM"
	default n
	help
	  If you enable this feature,
	  the LRA Estimated data will be stored on to a non-volatile memory
	  preferably on SEC_PARAM. If sec param is used, make sure to enable
	  at BL as well to match the param size.
```

## kernel_platform/msm-kernel/drivers/vibrator/cs/cs40l26/Kconfig
```kconfig
# SPDX-License-Identifier: GPL-2.0-only
#
# Input cs40l26 drivers configuration
#
config INPUT_CS40L26_I2C
	tristate "Cirrus Logic CS40L26 Haptic Driver (I2C)"
	depends on I2C
	select REGMAP_I2C
	help
	   Say Y here to enable support for CS40L26 boosted
	   haptic amplifier with I2C control port.

	   To complie the driver as a module choose M here: the
	   module will be called input_cs40l26_i2c.

config INPUT_CS40L26_SPI
	tristate "Cirrus Logic CS40L26 Haptic Driver (SPI)"
	depends on SPI_MASTER
	select REGMAP_SPI
	help
	   Say Y here to enable support for CS40L26 boosted
	   haptic amplifier with SPI control port.

	   To compile the driver as a module choose M here: the
	   module will be called input_cs40l26_spi.

config CS40L26_SAMSUNG_FEATURE
	bool "Cirrus CS40L26 Haptic Driver for Samsung feature"
	depends on INPUT_CS40L26_I2C
	default n
	help
	  Say Y to enable CS40L26_SAMSUNG_FEATURE
	  codes featured with this comment
	  aren't the original code from cirrus.
	  To use samsung concept, please enable this.

config CS40L26_SAMSUNG_USE_DVL
	bool "Cirrus CS40L26 Haptic Driver uses dvl bin"
	default n
	help
	  Say Y to enable CS40L26_SAMSUNG_USE_DVL.
	  is used for enabling dvl firmware load

config CS40L26_SAMSUNG_USE_MAX_DATA_TX_SIZE
	bool "Cirrus CS40L26 driver uses max data transfer size"
	depends on CS40L26_SAMSUNG_FEATURE
	default n
	help
	  Say Y to enable CS40L26_SAMSUNG_USE_MAX_DATA_TX_SIZE.
	  Samsung feature uses only 32 byte transfer due to SLSI AP's
	  I3C Regmap limitation. To use maximum data transfer size
	  please enable it.
```

## kernel_platform/msm-kernel/mm/sec_mm/Kconfig
```kconfig
menu "SEC Memory Management Options"

config SEC_MM
	tristate "Enable SEC MM"
	depends on ANDROID_VENDOR_HOOKS
	default m
	help
	  SEC memory management module.
	  With this feature enabled, system memory status and process lists
	  are printed in kernel log when the device goes low on file cache or
	  kernel panic events.
          This also supports tuning mm params via vendor hook.

config SEC_MM_DUMP_DMABUF_TASKS
	bool "Support for printing dmabuf usage information"
	depends on SEC_MM
	depends on !DMABUF_HEAPS_SAMSUNG_SYSTEM
	default y
	help
	  Print dmabuf usage information.

config MMAP_READAROUND_LIMIT
	int "Limit mmap readaround upperbound"
	default 16
	help
	  Inappropriate mmap readaround size can hurt device performance
	  during the sluggish situation. Add the hard upper-limit for
	  mmap readaround.

config HUGEPAGE_POOL
	tristate "hugepage pool management"
	default m
	depends on !HIGHMEM
	depends on !NEED_MULTIPLE_NODES
	depends on TRANSPARENT_HUGEPAGE
	depends on SEC_MM
	help
	  Enable this to provide 2MB hugepage to THP anon, ION, and GPU memory
	  allocation requests efficiently.

endmenu
```

## security/samsung/defex_lsm/Kconfig
```kconfig
config SECURITY_DEFEX
	bool "Defex Support"
	depends on SECURITY
	select CRYPTO
	select CRYPTO_RSA
	select CRYPTO_SHA1
	select CRYPTO_SHA256
	select CRYPTO_HASH_INFO
	select INTEGRITY_SIGNATURE
	select INTEGRITY_ASYMMETRIC_KEYS
	default n
	help
	  This selects the Defex support.
	  If you are unsure how to answer this question, answer N.

config SECURITY_DEFEX_GKI
	bool "Defex GKI build"
	depends on SECURITY_DEFEX
	default n
	help
	  This lets defex know whether to prepare the separate build, compatible with GKI.
	  Default value will be set to "y" if the build is GKI compatible.
	  And it will be changed to "n" by build.py at platform-build.

config SECURITY_DEFEX_NOBOOTPART
	bool "Defex nobootpart build"
	depends on SECURITY_DEFEX
	default n
	help
	  This config instructs do not use of boot partition to store the rules.
	  This is similar to SECURITY_DEFEX_GKI config, but allows the debug build.
	  The value should be set to "y" to work with disabled boot partition.

config DEFEX_KERNEL_ONLY
	bool "Defex Kernel Only"
	depends on SECURITY_DEFEX
	default n
	help
	  This lets defex know whether kernel-only build or not.
	  The value should be set to "y" if the build is kernel-only.

config SECURITY_DEFEX_USER
	bool "Defex USER build"
	depends on SECURITY_DEFEX
	default n
	help
	  This lets defex to know whether USER build performed or not
	  in case of TARGET_BUILD_VARIANT variable is empty.

config SECURITY_DEFEX_SINGLE_FILE
	bool "Defex single rule file"
	depends on SECURITY_DEFEX
	default n
	help
	  This lets defex to know whether device supports a single rule file or not.
	  If you are unsure how to answer this question, answer N.

config SECURITY_DEFEX_DTM
	bool "Defex Trusted Map"
	depends on SECURITY_DEFEX
	default n
	help
	  This lets defex to know whether device supports DTM or not.
	  If you are unsure how to answer this question, answer N.

config SECURITY_DEFEX_DTM_ENFORCING
	bool "Defex Trusted Map enforcing mode"
	depends on SECURITY_DEFEX
	default n
	help
	  This sets DEFEX DTM to enforcing mode.
	  If you are unsure how to answer this question, answer N.

config SECURITY_DEFEX_IMR
	bool "Immutable root"
	depends on SECURITY_DEFEX
	default n
	help
	  This lets defex to know whether device supports Immutble root or not.
	  If you are unsure how to answer this question, answer N.

config SECURITY_DEFEX_IMR_PERMISSIVE
	bool "Immutable root permissive"
	depends on SECURITY_DEFEX
	default n
	help
	  This lets defex to know whether device supports Immutble root permissive mode or not.
	  If you are unsure how to answer this question, answer N.

config SECURITY_DEFEX_IMR_V2
	bool "Immutable root v2"
	depends on SECURITY_DEFEX
	default n
	help
	  This lets defex to know whether device supports Immutable root v2 or not.
	  If you are unsure how to answer this question, answer N.

config SECURITY_DEFEX_IMR_V2_PERMISSIVE
	bool "Immutable root v2 permissive"
	depends on SECURITY_DEFEX
	default n
	help
	  This lets defex to know whether device supports Immutable root v2 permissive mode or not.
	  If you are unsure how to answer this question, answer N.

config SECURITY_DEFEX_SEC_FACTORY
	bool "Factory build"
	depends on SECURITY_DEFEX
	default n
	help
	  This lets defex to know whether device supports factory binary or not.
	  If you are unsure how to answer this question, answer N.
```
