## kernel_platform/build/kernel/kleaf/impl/defconfig/arm64_16k_defconfig
```kconfig
# CONFIG_ARM64_4K_PAGES is not set
CONFIG_ARM64_16K_PAGES=y
# CONFIG_ARM64_64K_PAGES is not set
# TODO(b/260919895): Support incfs on 16k pages
# CONFIG_INCREMENTAL_FS is not set
CONFIG_LOCALVERSION=""
```

## kernel_platform/build/kernel/kleaf/impl/defconfig/arm64_4k_defconfig
```kconfig
CONFIG_ARM64_4K_PAGES=y
# CONFIG_ARM64_16K_PAGES is not set
# CONFIG_ARM64_64K_PAGES is not set
CONFIG_LOCALVERSION="-4k"
```

## kernel_platform/build/kernel/kleaf/impl/defconfig/arm64_64k_defconfig
```kconfig
# CONFIG_ARM64_4K_PAGES is not set
# CONFIG_ARM64_16K_PAGES is not set
CONFIG_ARM64_64K_PAGES=y
# TODO(b/260919895): Support incfs on 64k pages
# CONFIG_INCREMENTAL_FS is not set
CONFIG_LOCALVERSION=""
```

## kernel_platform/build/kernel/kleaf/impl/defconfig/arm64_kasan_sw_tags_defconfig
```kconfig
CONFIG_KASAN=y
CONFIG_KASAN_SW_TAGS=y
CONFIG_KASAN_OUTLINE=y
# CONFIG_KASAN_HW_TAGS is not set
CONFIG_FRAME_WARN=0
```

## kernel_platform/build/kernel/kleaf/impl/defconfig/gcov_defconfig
```kconfig
CONFIG_GCOV_KERNEL=y
CONFIG_GCOV_PROFILE_ALL=y

# TODO(b/291710318) Allow section mismatch when using GCOV_PROFILE_ALL
#  modpost: vmlinux.o: section mismatch in reference: cpumask_andnot (section: .text) -> efi_systab_phys (section: .init.data)
CONFIG_SECTION_MISMATCH_WARN_ONLY=y
```

## kernel_platform/build/kernel/kleaf/impl/defconfig/gki_module_protection_disabled_defconfig
```kconfig
# ANDROID: Disable runtime symbol protection for debug builds
#
# CONFIG_MODULE_SIG_PROTECT is not set
```

## kernel_platform/build/kernel/kleaf/impl/defconfig/kasan_any_mode_defconfig
```kconfig
# Enable KASAN.
# The mode is unspecified and determined by defconfig of the
# kernel_build.
# If using software modes (generic or SW tag based), also use inline instrumentation types.

CONFIG_KASAN=y
CONFIG_KASAN_INLINE=y # nocheck: Not supported for HW tag based KASAN. See b/295240936
CONFIG_KCOV=y
# CONFIG_KASAN_OUTLINE is not set
CONFIG_FRAME_WARN=0
```

## kernel_platform/build/kernel/kleaf/impl/defconfig/kasan_generic_defconfig
```kconfig
CONFIG_KASAN=y
CONFIG_KCOV=y
CONFIG_KASAN_OUTLINE=y
CONFIG_FRAME_WARN=0
CONFIG_KASAN_GENERIC=y
# CONFIG_KASAN_HW_TAGS is not set
# CONFIG_KASAN_SW_TAGS is not set
```

## kernel_platform/build/kernel/kleaf/impl/defconfig/kcsan_defconfig
```kconfig
CONFIG_KCSAN=y
CONFIG_KCSAN_VERBOSE=y
# CONFIG_KCSAN_KCOV_BROKEN is not set
CONFIG_KCOV=y
CONFIG_KCOV_ENABLE_COMPARISONS=y
CONFIG_PROVE_LOCKING=y
# CONFIG_KASAN is not set
# CONFIG_KASAN_STACK is not set
CONFIG_FRAME_WARN=0
# CONFIG_KASAN_HW_TAGS is not set
# CONFIG_CFI is not set
# CONFIG_CFI_PERMISSIVE is not set
# CONFIG_CFI_CLANG is not set
```

## kernel_platform/build/kernel/kleaf/impl/defconfig/rust_defconfig
```kconfig
# Rust Support
# Until Rust is enabled in the primary GKI builds, this fragment enables
# support for Rust and Rust drivers being tested.

CONFIG_RUST=y
CONFIG_ANDROID_BINDER_IPC_RUST=y
CONFIG_ANDROID_BINDERFS_RUST=y
```

## kernel_platform/build/kernel/kleaf/tests/integration_test/ddk_negative_test/Kconfig
```kconfig
config DECLARED_SET
	bool "DECLARED_SET"

config DECLARED_UNSET
	bool "DECLARED_UNSET"
```

## kernel_platform/common/arch/arm64/configs/gki_sec_defconfig
```kconfig
# Samsung defconfig for GKI build
# SEC_PRODUCT_FEATURE_KNOX_SUPPORT_NPA
CONFIG_KNOX_NCM=y

# KNOX-DDAR
CONFIG_DDAR=y

# [ SEC_SELINUX_PORTING_COMMON
CONFIG_EXT4_FS_SECURITY=y
CONFIG_AUDIT=y
CONFIG_LSM_MMAP_MIN_ADDR=4096
CONFIG_SECURITY_SELINUX=y
CONFIG_DEFAULT_SECURITY_SELINUX=y
CONFIG_NETFILTER_ADVANCED=y
CONFIG_NETFILTER_XT_TARGET_LOG=y
CONFIG_SECURITY_SELINUX_DEVELOP=y
CONFIG_AUDITSYSCALL=y
CONFIG_PROC_AVC=y
# ] SEC_SELINUX_PORTING_COMMON

# FIPS
CONFIG_CRYPTO_SKC_FIPS=y



CONFIG_UH=y




CONFIG_RKP=y




CONFIG_KDP=y




CONFIG_FIVE=y




CONFIG_PROCA=y




CONFIG_PROCA_S_OS=y




# CONFIG_FIVE_TEE_DRIVER is not set




# CONFIG_FIVE_PA_FEATURE is not set




CONFIG_FIVE_GKI_10=y




CONFIG_PROCA_GKI_10=y




CONFIG_GAF=y




CONFIG_GAF_V6=y












































































CONFIG_SECURITY_DEFEX=y




CONFIG_SECURITY_DEFEX_USER=y




CONFIG_SECURITY_DEFEX_DTM=y




CONFIG_SECURITY_DEFEX_IMR=y




CONFIG_SMB_SERVER=y




CONFIG_SMB_SERVER_CHECK_CAP_NET_ADMIN=y




CONFIG_SECURITY_DSMS=y




CONFIG_SECURITY_KUMIHO=y




CONFIG_NTFS3_FS=y












CONFIG_NTFS3_LZX_XPRESS=y












CONFIG_NLS=y












CONFIG_EROFS_FS=y












CONFIG_F2FS_FS=y












CONFIG_F2FS_FS_SECURITY=y












CONFIG_F2FS_FS_COMPRESSION=y












CONFIG_EXT4_FS_POSIX_ACL=y
```

## kernel_platform/common/drivers/staging/samsung/fslog/Kconfig
```kconfig
# SPDX-License-Identifier: GPL-2.0
config PROC_FSLOG
        tristate "Enable FS logs for improving filesystem debug"
        depends on PROC_FS
        default y
	help
          This module provides a buffer for storing debugging information of
	  Filesystem and Storage. The debugging information stored here can be
	  used not only in the development stage but also to analyze market
	  problems. In addition, it does not provide a module build option to
	  leave logs for built-in modules. If you want to use the Filesystem
	  and Storage dedicated debugging buffer, then you must say Y.

config PROC_STLOG
        tristate "Support the interface for storage log"
        depends on PROC_FSLOG
        default y
	help
	  If you want to use the storage log, then you must say Y.

config PROC_DLOG
        tristate "Support the interface for delete log"
        depends on PROC_FSLOG
        default y
	help
	  If you want to use the delete log, then you must say Y.

config PROC_FSLOG_LOWMEM
        bool "Reserve small size buffer for low memory devices"
        depends on PROC_FSLOG
        default n
	help
	  FSLOG reserves 256KB for low memory devices, otherwise, 512KB.  If a
	  device might have small size memory and you need more free space in
	  DRAM, then you must say Y.
```

## kernel_platform/common/net/ncm/Kconfig
```kconfig
#
# Network Context Module Configuration
#
# SEC_PRODUCT_FEATURE_KNOX_SUPPORT_NPA {
config KNOX_NCM
  tristate "Network Context Module Support"
  depends on NET
  default y
  help
    This module provide some adition metadeta information related to packets

    If you want to compile it as a module, say M here.
    If unsure, say N.
# SEC_PRODUCT_FEATURE_KNOX_SUPPORT_NPA }
```

## kernel_platform/common/security/samsung/defex_lsm/Kconfig
```kconfig
config SECURITY_DEFEX
	bool "Defex Support"
	depends on SECURITY
	select CRYPTO
	select CRYPTO_RSA
	select CRYPTO_SHA1
	select CRYPTO_SHA256
	select CRYPTO_HASH_INFO
	select INTEGRITY_SIGNATURE
	select INTEGRITY_ASYMMETRIC_KEYS
	default n
	help
	  This selects the Defex support.
	  If you are unsure how to answer this question, answer N.

config SECURITY_DEFEX_GKI
	bool "Defex GKI build"
	depends on SECURITY_DEFEX
	default n
	help
	  This lets defex know whether to prepare the separate build, compatible with GKI.
	  Default value will be set to "y" if the build is GKI compatible.
	  And it will be changed to "n" by build.py at platform-build.

config DEFEX_KERNEL_ONLY
	bool "Defex Kernel Only"
	depends on SECURITY_DEFEX
	default n
	help
	  This lets defex know whether kernel-only build or not.
	  The value should be set to "y" if the build is kernel-only.

config SECURITY_DEFEX_USER
	bool "Defex USER build"
	depends on SECURITY_DEFEX
	default n
	help
	  This lets defex to know whether USER build performed or not
	  in case of TARGET_BUILD_VARIANT variable is empty.

config SECURITY_DEFEX_SINGLE_FILE
	bool "Defex single rule file"
	depends on SECURITY_DEFEX
	default n
	help
	  This lets defex to know whether device supports a single rule file or not.
	  If you are unsure how to answer this question, answer N.

config SECURITY_DEFEX_DTM
	bool "Defex Trusted Map"
	depends on SECURITY_DEFEX
	default n
	help
	  This lets defex to know whether device supports DTM or not.
	  If you are unsure how to answer this question, answer N.

config SECURITY_DEFEX_IMR
	bool "Immutable root"
	depends on SECURITY_DEFEX
	default n
	help
	  This lets defex to know whether device supports Immutble root or not.
	  If you are unsure how to answer this question, answer N.

config SECURITY_DEFEX_SEC_FACTORY
	bool "Factory build"
	depends on SECURITY_DEFEX
	default n
	help
	  This lets defex to know whether device supports factory binary or not.
	  If you are unsure how to answer this question, answer N.
```

## kernel_platform/msm-kernel/drivers/battery/charger/max77775_charger/Kconfig
```kconfig
config CHARGER_DUMMY
	bool "dummy charger driver"
	default n
	depends on BATTERY_SAMSUNG
	help
	  Say Y here to enable
	  support for dummy charger driver.
	  This driver source code implemented
	  skeleton source code for charger functions.

config CHARGER_MAX77775
	tristate "MAX77775 battery charger support"
	depends on BATTERY_SAMSUNG
	help
	  Say Y or M here to enable
	  support for the MAX77775 charger.
	  This includes boost mode.
	  This is Switching Mode Charger.

config MAX77775_CHECK_B2SOVRC
	bool "enable for check B2SOVRC"
	default n
	depends on CHARGER_MAX77775
	help
	  Say Y here to enable
	  support for CHARGER_MAX77775 check B2SCOVRC.
	  MAX77775 onply supports this checking options.
	  this is for MAX77775 monitoring B2SCOVRC.
	  
config SHIPMODE_BY_VBAT
	bool "enable for check shipmode by vbat"
	default n
	depends on CHARGER_MAX77775
	help
	  Say Y here to enable
	  support for SHIPMODE_BY_VBAT.
	  MAX77775 only supports this checking options.
	  this is for shipmode by vbat.
```

## kernel_platform/msm-kernel/drivers/battery/charger/max77968_charger/Kconfig
```kconfig
config CHARGER_MAX77968
	tristate "MAX77968 direct charger support"
	default y
	help
		Say Y or M here to enable
		support for the MAX77968 charger.
		This is Direct Mode Charger.
```
