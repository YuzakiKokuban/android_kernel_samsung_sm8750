## kernel_platform/msm-kernel/drivers/battery/wireless/Kconfig
```kconfig
menu "Wireless Charger drivers"

config WIRELESS_CHARGING
	tristate "support for wireless charging"
	default n
	help
	 Say Y to include support for wireless charging.
	 Wireless charging models should enable this charging option.
	 it include various scenario for wireless charging models only.

config WIRELESS_CHARGER_CPS4038
	tristate "MFC IC CPS4038 charger support"
	select WIRELESS_CHARGING
	depends on BATTERY_SAMSUNG && I2C
	help
	  Say Y here, to enable
	  support for the CPS4038 MFC IC
	  CPS4038 MFC include wireless charger driver.
	  It is for CPS(Conveninet Power Systems).

config WIRELESS_NO_HV
	bool "wireless no hv"
	depends on BATTERY_SAMSUNG && I2C
	help
	  Say Y here to enable
	  support for disable HV wireless charging.
	  If you are unsure, say N.
	  some models need this for not support high voltage wireless charging.

config WIRELESS_AUTH
	bool "support for samsung wireless authentication massage"
	default n
	depends on WIRELESS_CHARGING
	help
	  Say Y here to enable
	  support for wireless authentication message.
	  It is for samsung wireless authentication.
	  wireless charging flagship models should enable this option.

config WIRELESS_CHARGER_HIGH_VOLTAGE
	bool "high voltage wireless charger"
	default n
	depends on WIRELESS_CHARGING
	help
	  Say Y here to enable
	  support for wireless fast charging.
	  It is for fast wireless charging.
	  wireless charging flagship models should enable this option.

config WIRELESS_TX_MODE
	bool "wireless power sharing support in sec battery driver"
	default n
	depends on WIRELESS_CHARGING
	help
	  Say Y here to enable
	  support for wireless tx mode.
	  It is for wireless power sharing.
	  wireless tx support models should enable this option.

config WIRELESS_FIRMWARE_UPDATE
	bool "WIRELESS IC firmware update support"
	default n
	depends on WIRELESS_CHARGING
	help
	  Say Y here to enable
	  support for the wireless charger IC firmware update.
	  it need firmware bin in firmware folder.
	  It is for MFC IC.

config WIRELESS_IC_PARAM
	bool "WIRELESS IC info param support"
	depends on WIRELESS_CHARGING
	help
	  Say Y here to enable
	  support for the WIRELESS IC info param.
	  It is for wireless ic dualization.
	  such as use of IDT and LSI.

config TX_GEAR_PHM_VOUT_CTRL
    bool "control vout when gear`s phm"
    default n
    depends on WIRELESS_TX_MODE
    help
	  Say Y to enable CONFIG_TX_GEAR_PHM_VOUT_CTRL
	  Control vout 5v when enter gear`s phm with high voltage wired charging
	  Recover vout when escape gear`s phm
	  This is considered only if high vout with gear.

config WIRELESS_RX_PHM_CTRL
    bool "control phm rx itself"
    default n
    depends on WIRELESS_CHARGING
    help
	  Say Y to enable CONFIG_WIRELESS_RX_PHM_CTRL
	  Control rx phm itself during wireless charging.

config TX_GEAR_AOV
    bool "control adaptive vout when tx gear"
    default n
    depends on WIRELESS_TX_MODE
    help
	  Say Y to enable CONFIG_TX_GEAR_AOV
	  AOV : Adaptive Operation Voltage
	  When tx gear, control vout adaptively.
	  This is for tx gear with thick cover.

config ENABLE_WIRELESS_IRQ_IN_SLEEP
	bool "support for enable irq in sleep"
	default n
	depends on WIRELESS_CHARGING
	help
	  Say Y here to enable
	  support for enable irq in sleep
	  In Qualcomm AP, wireless charging does not work,
	  when irq is disabled in sleep .

config CPS4038_CHARGER_TEST_FOR_ONLY_UML
	tristate "KUnit test for cps4038_charger_test"
	depends on SEC_KUNIT
	depends on UML
	depends on WIRELESS_CHARGER_CPS4038
	help
	  TODO: Describe config fully.
	  This CONFIG is recommended to set to y.

endmenu


menu "Wireless Charger drivers"

config WIRELESS_CHARGING
	tristate "support for wireless charging"
	default n
	help
	 Say Y to include support for wireless charging.
	 Wireless charging models should enable this charging option.
	 it include various scenario
	 for wireless charging models only.

config WIRELESS_CHARGER_STWLC89
	tristate "MFC IC STWLC89 charger support"
	select WIRELESS_CHARGING
	depends on BATTERY_SAMSUNG && I2C
	help
	  Say Y here, to enable
	  support for the STWLC89 MFC IC
	  STWLC89 MFC include wireless charger driver.
	  It is for STMicroelectronics.

config WIRELESS_NO_HV
	bool "wireless no hv"
	depends on BATTERY_SAMSUNG && I2C
	help
	  Say Y here to enable
	  support for disable HV wireless charging.
	  If you are unsure, say N.
	  some models need this for not support high voltage wireless charging.

config WIRELESS_AUTH
	bool "support for samsung wireless authentication massage"
	default n
	depends on WIRELESS_CHARGING
	help
	  Say Y here to enable
	  support for wireless authentication message.
	  It is for samsung wireless authentication.
	  wireless charging flagship models should enable this option.

config WIRELESS_CHARGER_HIGH_VOLTAGE
	bool "high voltage wireless charger"
	default n
	depends on WIRELESS_CHARGING
	help
	  Say Y here to enable
	  support for wireless fast charging.
	  It is for fast wireless charging.
	  wireless charging flagship models should enable this option.

config WIRELESS_TX_MODE
	bool "wireless power sharing support in sec battery driver"
	default n
	depends on WIRELESS_CHARGING
	help
	  Say Y here to enable
	  support for wireless tx mode.
	  It is for wireless power sharing.
	  wireless tx support models should enable this option.

config WIRELESS_FIRMWARE_UPDATE
	bool "WIRELESS IC firmware update support"
	default n
	depends on WIRELESS_CHARGING
	help
	  Say Y here to enable
	  support for the wireless charger IC firmware update.
	  it need firmware bin in firmware folder.
	  It is for MFC IC.

config WIRELESS_IC_PARAM
	bool "WIRELESS IC info param support"
	depends on WIRELESS_CHARGING
	help
	  Say Y here to enable
	  support for the WIRELESS IC info param.
	  It is for wireless ic dualization.
	  such as use of IDT and LSI.

config TX_GEAR_PHM_VOUT_CTRL
    bool "control vout when gear`s phm"
    default n
    depends on WIRELESS_TX_MODE
    help
	  Say Y to enable CONFIG_TX_GEAR_PHM_VOUT_CTRL
	  Control vout 5v when enter gear`s phm with high voltage wired charging
	  Recover vout when escape gear`s phm
	  This is considered only if high vout with gear.

config WIRELESS_RX_PHM_CTRL
    bool "control phm rx itself"
    default n
    depends on WIRELESS_CHARGING
    help
	  Say Y to enable CONFIG_WIRELESS_RX_PHM_CTRL
	  Control rx phm itself during wireless charging.

config TX_GEAR_AOV
    bool "control adaptive vout when tx gear"
    default n
    depends on WIRELESS_TX_MODE
    help
	  Say Y to enable CONFIG_TX_GEAR_AOV
	  AOV : Adaptive Operation Voltage
	  When tx gear, control vout adaptively.
	  This is for tx gear with thick cover.

config ENABLE_WIRELESS_IRQ_IN_SLEEP
	bool "support for enable irq in sleep"
	default n
	depends on WIRELESS_CHARGING
	help
	  Say Y here to enable
	  support for enable irq in sleep
	  In Qualcomm AP, wireless charging does not work,
	  when irq is disabled in sleep .

endmenu
```

## kernel_platform/msm-kernel/drivers/fingerprint/Kconfig
```kconfig
#
# Sensor  drivers configuration
#
menuconfig SENSORS_FINGERPRINT
	tristate "Finger Print Sensor devices"
	help
	  Say Y here, and a list of sensors drivers will be displayed.
	  Everything that didn't fit into the other categories is here. This option
	  doesn't affect the kernel.
	  If unsure, say Y.

config FINGERPRINT_SECURE
	tristate "fingerprint sensor support"
	default n
	help
	  If you say yes here you get support for Trustzone.

config SENSORS_FPRINT_SECURE
	tristate "fingerprint sensor support"
	default n
	help
	  If you say yes here you get support for Trustzone.
	  In case of user binary, fingerprint sensor operates within trustzone.
	  If this feature enabled, spi communication is controlled by Trusted Application.
	  Then it should be enabled in the user binary.

config SENSORS_FINGERPRINT_MODULE
	bool "module build"
	default n
	help
	  You choose yes if you are using module build on fingerprint.

config SENSORS_FINGERPRINT_LSI
	tristate "System LSI AP support"
	default n
	help
	  If you say yes here you get support for System LSI AP.

config SENSORS_FINGERPRINT_QCOM
	tristate "Qualcomm AP support"
	default n
	help
	  If you say yes here you get support for Qualcomm AP.

config SENSORS_FINGERPRINT_MTK
	tristate "Mediatek AP support"
	default n
	help
	  If you say yes here you get support for Mediatek AP.

config SENSORS_FINGERPRINT_NORMALSPI
	tristate "Goodix SPI normal mode"
	default n
	help
	  If you say yes here you get to use spi normal mode on goodix sensor.

config SENSORS_FINGERPRINT_32BITS_PLATFORM_ONLY
	tristate "32bits platform support"
	default n
	help
	  If you say yes here you get support for 32bits platform.

config SENSORS_QBT2000
	tristate "QBT2000 fingerprint sensor support"
	default n
	help
	  If you say yes here you get support for Qualcomm's
	  fingerprint sensor QBT2000.

config SENSORS_QFS4008
	tristate "QFS4008 fingerprint sensor support"
	default n
	help
	  If you say yes here you get support for Qualcomm's
	  fingerprint sensor QFS4008.

config SENSORS_ET5XX
	tristate "ET5XX fingerprint sensor support"
	default n
	help
	  Fingerprint sensor driver.
	  If you say yes here you get support for ET5XX sensor.
	  ET5XX is the touch type fingerprint sensor.
	  ET5XX module can support WOF mode.

config SENSORS_EC6XX
	tristate "EC6XX fingerprint sensor support"
	default n
	help
	  Fingerprint sensor driver.
	  If you say yes here you get support for EC6XX sensor.
	  EC6XX is the touch type fingerprint sensor.
	  EC6XX module can support WOF mode.

config SENSORS_ET7XX
	tristate "ET7XX fingerprint sensor support"
	default n
	help
	  If you say yes here you get support for Egistec's
	  fingerprint sensor ET7XX.

config SENSORS_EL7XX
	tristate "EL7XX fingerprint sensor support"
	default n
	help
	  If you say yes here you get support for Egistec's
	  fingerprint sensor EL7XX.

config SENSORS_GW3X
	tristate "generic goodix fingerprint driver"
	default n
	help
	  If you say yes here you get support for Goodix's
	  fingerprint sensor GW36X.

config SENSORS_GW9558X
	tristate "generic goodix fingerprint driver"
	default n
	help
	  If you say yes here you get support for Goodix's
	  fingerprint sensor GW9558X.
```

## kernel_platform/msm-kernel/drivers/firmware/cirrus/Kconfig
```kconfig
# SPDX-License-Identifier: GPL-2.0-only

config FW_CS_DSP
	tristate
	default n

# SPDX-License-Identifier: GPL-2.0-only
comment "Cirrus firmware configs"

config CIRRUS_FIRMWARE_CL_DSP
        tristate "Cirrus Logic Haptics DSP driver"
        help
           This driver is used to handle firmware loading
           and configuration for Cirrus Logic Haptic devices.
```
