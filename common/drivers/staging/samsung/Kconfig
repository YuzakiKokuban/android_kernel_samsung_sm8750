## drivers/samsung/bsp/argos/Kconfig
```kconfig
config ARGOS
	tristate "Throughput monitoring Feature"
	help
	  This option enables monitoring the data throughput and doing several actions for
	  enhancing the performance such as adjusting the CPU freqency, allocating the tasks
	  to the appropriate CPU and so on

config ARGOS_THROUGHPUT
	default y if ARGOS=m
	default n if ARGOS=y
	bool "argos Throughput device"
	help
	  This option make /dev/network_throughput in sec_argos module
	  for substitiution of pm qos /dev/network_throughput
	  which is deprecated in kernel 5.4.

config ARGOS_VOTING_DDR
	default n
	depends on ARGOS
	bool "argos voting ddr clock"
	help
	  This option enable ddr voting part in sec_argos module.
```

## drivers/samsung/bsp/class/Kconfig
```kconfig
config SEC_CLASS
	tristate "Samsung sec class/sysfs Feature"
	select DRV_SAMSUNG
	help
	  Samsung sysfs name 'sec' directory create

# legacy compatibility
config DRV_SAMSUNG
	bool
```

## drivers/samsung/bsp/of_kunit/Kconfig
```kconfig
config SEC_OF_KUNIT
	tristate "Samsung additional facilites for of / kunit testing"
	depends on OF && KUNIT
	default n
	help
	  TODO: help is not ready.
```

## drivers/samsung/bsp/qcom/param/Kconfig
```kconfig
config SEC_QC_PARAM
	tristate "Samsung PARAM driver for RAW Partion & Qualcomm based devices"
	depends on SEC_PARAM
	help
	  TODO: help is not ready.

config SEC_QC_PARAM_TEST_FOR_ON_DEVICE
	tristate "KUnit test for sec_qc_param_test"
	depends on KUNIT
	depends on SEC_QC_PARAM
	help
	  TODO: Describe config fully.
	  If you run this test driver on device, SHOULD set this config as 'm' to build test driver modulraly.

config SEC_QC_PARAM_TEST_FOR_ONLY_UML
	tristate "KUnit test for sec_qc_param_test"
	depends on KUNIT
	depends on UML
	depends on SEC_QC_PARAM
	help
	  TODO: Describe config fully.
	  This CONFIG is recommended to set to y.
```

## drivers/samsung/debug/arm64/Kconfig
```kconfig
source "drivers/samsung/debug/arm64/ap_context/Kconfig"
source "drivers/samsung/debug/arm64/fsimd_debug/Kconfig"
source "drivers/samsung/debug/arm64/debug/Kconfig"
```
