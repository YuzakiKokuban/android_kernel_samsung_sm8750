## drivers/battery/fuelgauge/max77775_fuelgauge/Kconfig
```kconfig
menu "Fuelgauge drivers"

config FUELGAUGE_DUMMY
	bool "dummy fuel gauge driver"
	default n
	depends on BATTERY_SAMSUNG
	help
	  Say Y here, to enable
	  support for dummy fuel gauge driver.
	  This driver source code implemented
	  skeleton source code for fuel gauge functions.

config FUELGAUGE_MAX77775
	tristate "MAX77775 fuel gauge driver"
	default n
	depends on BATTERY_SAMSUNG
	help
	  Say Y or M here, to enable
	  support for MAXIM MAX77775 fuel gauge driver.
	  This is fuel-gauge systems for monitoring batteries.
	  This fuel-gauge can be used in coulomb-counting mode.

config EN_OOPS
	bool "enable oops filter"
	default n
	help
	  Say Y here to enable
	  support for FUELGAUGE_MAX77775 enable oops filter.
	  MAXIM fuel-gauge only support this option.
	  some battery data values should be defined.

config ID_USING_BAT_SUBBAT
	bool "battery id using sub bat"
	default n
	depends on DUAL_BATTERY
	help
	  Say Y here to enable
	  This is to calculate bat_id using main_bat_id & sub_bat_id.

config UI_SOC_PROLONGING
	bool "Ui Soc 100% Prolonging"
	default n
	help
	  Say Y here to enable
	  Support for UI Soc prolonging.
	  This is to enable UI Soc prolonging concept.

endmenu
```

## drivers/input/misc/hall/akm/Kconfig
```kconfig
config INPUT_DIGITAL_HALL_AKM
	tristate "Enable AKM DIGITAL HALL IC"
	depends on I2C
	help
	  Say Y to enable support of akm digital hall ic.

	  To compile this driver as a module, choose M here: the
	  module will be called akm.
```

## drivers/input/sec_input/Kconfig
```kconfig
# SPDX-License-Identifier: GPL-2.0-only
#
# SEC Input device configuration
#

config INPUT_SEC_INPUT
	tristate "Support for SEC input layer"
	help
	  Say Y here if you want to use sec cmd.

config SEC_DEBUG_TSP_LOG
	tristate "Support for tsp_msg"
	help
	  Say Y here if you want to use tsp_msg node.

config INPUT_TOUCHSCREEN_TCLMV2
	tristate "touchscreen tclmv2"
	help
	  Say Y here if you want to use tclm.

config INPUT_SEC_SECURE_TOUCH
	tristate "input sec secure touch"
	depends on INPUT
	help
	  Say Y here if you need to use sec secure touch.

config INPUT_SEC_TRUSTED_TOUCH
	tristate "input sec secure touch"
	depends on INPUT
	help
	  Say Y here if you need to use sec secure touch.

config TOUCHSCREEN_DUMP_MODE
	tristate "touchscreen dump mode"
	help
	  Say Y here if you need to get raw data.

config INPUT_SEC_NOTIFIER
	tristate "input sec notifier"
	help
	  Say Y here if you need to use input notifier.

config SEC_INPUT_HEADER
	bool "include sec_input header under include linux input"
	help
	  Say Y here if you copy headers under include/linux/input.

config SEC_INPUT_MULTI_DEVICE
	tristate "Multi device for Foldable"
	help
	  Say Y here if you need to use Multi device.

config SEC_INPUT_CMD_TEST
	tristate "KUnit test for tsp_common_test"
	depends on SEC_KUNIT
	help
	  TODO: Describe config fully.

config SEC_INPUT_TEST
	tristate "KUnit test for sec_input_test"
	depends on SEC_KUNIT
	help
	  TODO: Describe config fully.

config SEC_INPUT_RAWDATA
	tristate "input rawdata"
	help
	  Say Y hear if you need to use rawdata.
```

## drivers/input/sec_input/synaptics_s3916t/Kconfig
```kconfig
# SPDX-License-Identifier: GPL-2.0-only
#
# SYNAPTICS TOUCH driver configuration
#

config TOUCHSCREEN_SYNAPTICS_S3916T_SPI
    tristate "SYNAPTICS S3916T SPI Touchscreen"
    depends on SPI
    help
      Say Y here if you want support for SYNAPTICS SPI touchscreen controllers.
      If unsure, say N.

config TOUCHSCREEN_SYNAPTICS_S3916T_I2C
    tristate "SYNAPTICS S3916T I2C Touchscreen"
    depends on I2C
    help
      Say Y here if you want support for SYNAPTICS I2C touchscreen controllers.
      If unsure, say N.
```

## drivers/knox/kzt/Kconfig
```kconfig
# @file Kconfig
# @brief Kconfig for Next Generation Knox Security Driver
# Copyright (c) 2024, Samsung Electronics Corporation. All rights reserved.
#
# This program is free software; you can redistribute it and/or modify
# it under the terms of the GNU General Public License version 2 and
# only version 2 as published by the Free Software Foundation.
#
# This program is distributed in the hope that it will be useful,
# but WITHOUT ANY WARRANTY; without even the implied warranty of
# MERCHANTABILITY or FITNESS FOR A PARTICULAR PURPOSE.  See the
# GNU General Public License for more details.

config KZT
	tristate "Knox Zero Trust feature enable"
	help
	  To have the Knox Zero Trust be fully functioning,
	  some kernel support is required.
```

## drivers/kperfmon/Kconfig
```kconfig
#
# Samsung Performance Logging system
#

menu "samsung Performace manager"

config KPERFMON
	bool "Enable performance log"
	default y
	help
		Samsung performance log(OLOG).
		Say Y here if enable performance olog driver to do logging system resources.
		When some delay occurs in the kernel, native or user user space,
		the logging information should be restored into the system.

config KPERFMON_BUILD
	tristate "Building tyoe of performance log"
	default y
	help
		Samsung performance log(OLOG).
		This is to set a build type for module or build-in.
		Say m here if you want a module of performance olog driver.
		Say y here if you want build-in object of the performance olog driver.

endmenu
```

## drivers/mfd/slsi/s2mpb02/Kconfig
```kconfig
config MFD_S2MPB02
	tristate "Samsung Semiconductor S2MPB02 PMIC Support"
	depends on I2C=y
	select MFD_CORE
	help
	  Say yes here to support for Samsung Semiconductor S2MPB02.
	  This is a Power Management IC with Flash on chip.
	  This driver provides common support for accessing the device;
	  additional drivers
```

## drivers/muic/common/Kconfig
```kconfig
#
# MUIC devices
#

comment "MUIC configs"

config USE_MUIC
	bool "Using MUIC device driver"
	depends on I2C
	default n
	help
	  If you say yes here you will get support for
	  the MUIC device driver.

config MUIC_NOTIFIER
	tristate "MUIC notifier support"
	depends on USE_MUIC
	default n
	help
	  If you say yes here you will get support for
	  the MUIC attached device status change notification.

config MUIC_HV
	bool "MUIC_HV"
	depends on USE_MUIC
	default n
	help
	  If you say yes here you will get support for the AFC.

config MUIC_SUPPORT_PDIC
	tristate "MUIC supports CCIC chip interface"
	depends on USE_MUIC
	default n
	help
	  If you say yes here you will get support for the CCIC chip.

config HICCUP_CHARGER
	bool "Using HICCUP charger"
	depends on USE_MUIC
	default n
	help
		If you say yes here you will get support for
		for the hiccup charger feature.

config USE_SECOND_MUIC
	bool "Using second MUIC"
	depends on USE_MUIC
	default n
	help
		If you say yes here you will get support for
		for the second MUIC chip feature.

config MUIC_UART_SWITCH
	bool "UART SWITCH"
	depends on USE_MUIC
	default n
	help
	  If you say yes here you will get support for the SEC UART SWITCH chip.
	  It needs additional uart select H/W and applied only to lsi.

config MUIC_SUPPORT_UART_SEL
	bool "MUIC supports uart selection"
	depends on USE_MUIC
	default n
	help
	  If you say yes here you will get support for the uart selection.
	  It applied only to qc.

config USE_DEDICATED_MUIC
	bool "Using dedicated MUIC device driver"
	depends on USE_MUIC
	default n
	help
	  If you say yes here you will get support for
	  Dedicated MUIC device driver.
	  This is only for charge

config MUIC_AFC_RETRY
	bool "Using MUIC AFC retry"
	depends on USE_MUIC
	default n
	help
	  If you say yes here you will get support for MUIC AFC retry feature.

config MUIC_COMMON_SYSFS
	bool "Using muic sysfs Features"
	depends on MUIC_NOTIFIER
	default n
	help
	  If you say yes here you will get support for the muic sysfs.
	  some ic drivers may have sysfs in own driver.
	  But we recommend driver to use this common sysfs.
	  new ic driver must use this feature.
  
config MUIC_USE_MODULE_PARAM
	bool "Using module param"
	depends on MUIC_NOTIFIER
	default n
	help
	  If this feature is enabled, muic_core will use module_param directly.
	  Should not use extern variable and __setup for param.
	  need to add cmdline in bootloader.
	  (ex: common_muic.xxx)

config HICCUP_CC_DISABLE
	bool "Using HICCUP CC disable"
	depends on USE_MUIC
	default n
	help
	  If you say yes here you will get support for
	  for the hiccup cc disable feature.

config MUIC_POGO
	bool "Using muic pogo"
	depends on USE_MUIC
	default n
	help
	  If you say yes here you will get support for muic pogo

config MUIC_LO_TA_LOW_CURRENT
	bool "Using LO_TA_LOW_CURRENT"
	depends on USE_MUIC
	default n
	help
	  If you say yes here you will get support for
		for the hiccup cc disable feature.

config MUIC_CORE_TEST_FOR_ON_DEVICE
	tristate "KUnit test for muic_core_test"
	depends on KUNIT
	depends on MUIC_NOTIFIER
	help
	  This is feature for muic-core.c
	  If you run this test driver on device,
	  SHOULD set this config as 'm' to build test driver modularly.
	  refer to muic_common.py file.

config MUIC_CORE_TEST_FOR_ONLY_UML
	tristate "KUnit test for muic_core_test"
	depends on KUNIT
	depends on UML
	depends on MUIC_NOTIFIER
	help
	  This is feature for muic-core.c
	  This CONFIG is recommended to set to y.
	  If you run UML test, this feature must be enabled.
	  refer to muic_common.py file.
```

## drivers/nfc/nxp_combined/Kconfig
```kconfig
#
# near field communication configuration
#
config SAMSUNG_NFC
	tristate "Samsung NFC driver"
	default n
	help
	  Say Y here if you want to build support for NFC (Near field
	  communication) devices.
	  To compile this support as a module, choose M here: the module will
	  be called nfc.

config NFC_NXP_COMBINED
	bool "NXP COMBINED driver Feature"
	default n
	help
	  NXP Near Field Communication controller support.
	  If this feature is enabled, sn2xx driver can support various ICs
	  such as PN557, sn1xx and sn2xx.
	  For one binary, this driver should be used.

config NFC_SN2XX
	bool "NXP SN2XX Feature"
	default n
	help
	  NXP SN2XX Near Field Communication controller support
	  This option enables device driver support for the NFC.
	  It is used by many services. NFC is fully controlled using I2C
	  to communicate the AP chip.

config NFC_SN2XX_ESE_SUPPORT
	tristate "Nxp secure element protocol driver (SPI) devices"
	depends on SPI
	help
	  This enables the Secure Element driver for SNxxx based devices.
	  If unsure, say N.
	  This selects Secure Element support.
	  If you want NFC support, you should say Y here and
	  also to your specific host controller driver.

config ESE_USE_TZ_API
        bool "use tz api"
        depends on NFC_SN2XX_ESE_SUPPORT
        default n
        help
          Enable when using TZ API.
	  You should select this feature if your NFC product
          uses S.LSI AP and TZ API.
	  Say Y here to compile support for TZ API.

config SEC_NFC_LOGGER
        bool "NFC logger"
        default n
        help
          Enable NFC log.
          NFC log will be recorded at proc folder.
          but will not included at dumpstate log.
          so need to copy this file to log folder.

config NFC_LOGGER_LOWMEM
       bool "NFC logger low memory"
       default n
       help
         Reduces NFC log buffer size.
         This option reduces the size of the nfc log buffer in order to save memory on low-memory devices.
         By reducing its size, we can free up memory for other purposes,
         but it may also result in some log messages being lost if the buffer fills up quickly.

config SEC_NFC_WAKELOCK_METHOD
        int "nfc wakelock method"
        default 0
        help
          Different functions must be used depending on the kernel version
          for wakelock initialization.
          0 - auto selection
          1 - wakeup_source_init
          2 - wakeup_source_register

config SEC_NFC_LOGGER_ADD_ACPM_LOG
        bool "NFC logger: add acpm log"
        default n
        depends on SEC_NFC_LOGGER
        help
          add acpm log.
          this feature is for particualr AP.
          rtc reg addr is needed to compare time

config SEC_NFC_LOGGER_RTC_REG_ADDR
        hex "NFC logger: add acpm log"
        default 0x0
        depends on SEC_NFC_LOGGER_ADD_ACPM_LOG
        help
          RTC time is to compare between acpm and kernel.
          address value is hex.

config MAKE_NODE_USING_PLATFORM_DEVICE
        bool "eSE platform driver"
        default n
        help
          Using eSE platform driver.
          Sometimes eSE node is created after permission setting
          cause of SPI driver dependency.
          So, use platform driver to make node first.

config SEC_STAR
        tristate "LSI star platform"
        default n
        help
          LSI star platform
          This driver provides support for LSI star platform.

config STAR_MEMORY_LEAK
        bool "memory leak test in sec-star"
        help
          memory leak test in sec-star.
          All allocated memory are listed in array.

config STAR_K250A
        bool "S.LSI k250a driver"
        help
          S.LSI k250a driver except ISO7816 protocol layer
          This driver provides support for S.LSI k250a product.

config NFC_QTI_I2C
        tristate "QTI NCI based NFC I2C Driver for SNxxx"
        depends on I2C
        help
          This enables the NFC driver for SNxxx based devices.
          This is for I2C connected version. NCI protocol logic
          resides in the usermode and it has no other NFC dependencies.

          If unsure, say N.

config CLK_ACPM_INIT
	bool "ACPM INIT"
	default n
	help
	  ACPM INIT must be called to use CLK3 in S5910.

config SEC_NFC_EINT_EXYNOS
        bool "enable eint mode for nfc clk"
        help
          This feature enable eint mode for nfc clk
          Need to trigger clk by clk req
          It is necessary for slsi ap if clk_req is assigned to no dedicated gpio.
```

## drivers/optics/Kconfig
```kconfig
config SENSORS_FLICKER_SELF_TEST
	tristate "Flicker EOL test use flash"
	help
		make Test environment using led flash.

config SENSORS_STK6D2X
	tristate "STK STK68210 ALS, Flicker sensor"
	depends on I2C
	help
	  If you say yes here, you get support for the STK STK68210.
	  This driver can also be built as a module.
	  If so, the module will be called flicker_sensor.

config FLICKER_PWM_CALIBRATION
	bool "Support Flicker OSC Calibration"
	help
	  Using PWM pulse, Enhance resolution accuracy
	  This config just enable sensor side functions.
```

## drivers/regulator/s2mpb02/Kconfig
```kconfig
if REGULATOR

config REGULATOR_S2MPB02
	tristate "Samsung S2MPB02 regulator"
	depends on MFD_S2MPB02
	help
	 This driver controls a Samsung S2MPB02 regulator
	 via I2C bus.

endif
```

## drivers/samsung/Kconfig
```kconfig
source "drivers/samsung/bsp/Kconfig"
source "drivers/samsung/debug/Kconfig"
source "drivers/samsung/power/Kconfig"
source "drivers/samsung/ipc/Kconfig"
```

## drivers/samsung/bsp/Kconfig
```kconfig
menu "Samsung Factory Feature"
config SEC_FACTORY
	bool "when it comes to sec factory mode"
	default n
	select SEC_PANIC_PCIE_ERR
	help
	  It will support a sec factory mode
endmenu

config SEC_FACTORY_INTERPOSER
	bool "Samsung Factory interposer binary"
	default n
	help
	  Samsung Factory interposer binary

config SAMSUNG_PRODUCT_SHIP
	bool "set up for product shipping"
	default n

source "drivers/samsung/bsp/class/Kconfig"
source "drivers/samsung/bsp/param/Kconfig"
source "drivers/samsung/bsp/key_notifier/Kconfig"
source "drivers/samsung/bsp/reloc_gpio/Kconfig"
source "drivers/samsung/bsp/argos/Kconfig"
source "drivers/samsung/bsp/of_kunit/Kconfig"
source "drivers/samsung/bsp/blk_helper/Kconfig"

source "drivers/samsung/bsp/qcom/Kconfig"
```
