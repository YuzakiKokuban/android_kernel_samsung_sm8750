## common/drivers/staging/samsung/Kconfig
```kconfig
# SPDX-License-Identifier: GPL-2.0
menu "SAMSUNG OGKI debugging features"

source "drivers/staging/samsung/fat_common/Kconfig"

source "drivers/staging/samsung/fslog/Kconfig"

endmenu # SAMSUNG_MX
```

## common/security/samsung/proca/Kconfig
```kconfig
#
# PROCA feature configuration
#

config PROCA
	bool "Process Authenticator"
	depends on FIVE
	default n
	help
	   Enable Process Authenticator

config PROCA_GKI_10
	bool "GKI 1.0 compatible version of PROCA"
	depends on PROCA
	default y if FIVE_GKI_10
	default n
	help
	   Build GKI 1.0 compatible version of PROCA

config PROCA_S_OS
	bool "S OS compatible version of PROCA"
	depends on PROCA
	default n
	help
	   Build S OS compatible version of PROCA

choice
	prompt "Choose PROCA certificate storage type"
	default PROCA_CERTIFICATES_XATTR
	depends on PROCA_S_OS
	help
	  This option allows to choose type of storage for certificates.
	  There are two options: storage in xattr or in the database.

config PROCA_CERTIFICATES_XATTR
	bool "Xattr for certificates"
	help
	   Use xattr for PROCA certificates

config PROCA_CERTIFICATES_DB
	bool "PROCA database for certificates"
	help
	   Use database for PROCA certificates
endchoice

config PROCA_CERT_ENG
    string "PROCA certificate to verify signatures for eng binary"
    depends on PROCA
    default "x509_proca_eng.der"
    help
      Path to CERT which will be built-in to eng binary

config PROCA_CERT_USER
    string "PROCA certificate to verify signatures for user binary"
    depends on PROCA
    default "x509_proca_user.der"
    help
      Path to CERT which will be built-in to user binary

config PROCA_CERT_DEVICE
	bool "PROCA certificate device"
	depends on PROCA_CERTIFICATES_DB && !SAMSUNG_PRODUCT_SHIP
	default y if PROCA_CERTIFICATES_DB && !SAMSUNG_PRODUCT_SHIP
	default n
	help
	   Enable the certificate device /dev/proca_cert for reading and
	   updating test database in /data/proca.db

config PROCA_DEBUG
	bool "PROCA Debug mode"
	depends on PROCA && !SAMSUNG_PRODUCT_SHIP
	default y
	help
	   Enable the debug mode in the PROCA. When this option is enabled
	   PROCA driver creates file /proc/<pid>/integrity/proca_certificate
	   which contains hex representation of binary proca certificate. It
	   might be used to check existence of task descriptor for some task
	   in proca table.
```

## drivers/adsp_factory/Kconfig
```kconfig
#
# factory sensor drivers configuration
#
config ADSP_FACTORY
	tristate "MSM ADSP factory driver"
	help
	  This driver communicate with SSC DAEMON.
	  register each sensor device.
	  send selftest request using netlink.
	  receive test result using netlink.

config LSM6DSO_FACTORY
	bool "factory test for SSC - LSM6DSO"
	depends on ADSP_FACTORY
	help
	  lsm6dso factory driver.
	  provide sysfs for factory test.
	  request selftest to adsp_factory.
	  receive test result from adsp_factory.

config LSM6DSL_FACTORY
	bool "factory test for SSC - LSM6DSL"
    depends on ADSP_FACTORY
	help
	  lsm6dsl factory driver.
	  provide sysfs for factory test.
	  request selftest to adsp_factory.
	  receive test result from adsp_factory.

config LSM6DSV_FACTORY
	bool "factory test for SSC - LSM6DSV"
	depends on ADSP_FACTORY
	help
	  lsm6dsv factory driver.
	  provide sysfs for factory test.
	  request selftest to adsp_factory.
	  receive test result from adsp_factory.

config SUPPORT_ACCEL_HIGHG
	bool "support HIGH G ACCEL"
	depends on ADSP_FACTORY
	help
	  highg accel factory driver.
	  provide sysfs for factory test.
	  request selftest to adsp_factory.
	  receive test result from adsp_factory.

config AK09918_FACTORY
	bool "factory test for SSC - ak09918"
    depends on ADSP_FACTORY
	help
	  ak09918 factory driver.
	  provide sysfs for factory test.
	  request selftest to adsp_factory.
	  receive test result from adsp_factory.

config SUPPORT_MAG_ABS_SUM
	tristate "mag abs sum for SSC"
	depends on AK09918_FACTORY
	help
	  Support the mag abs sum check
	  check the mag abs sum value.

config LPS22HH_FACTORY
	bool "factory test for SSC - lps22hh"
    depends on ADSP_FACTORY
	help
	  lps22hh factory driver.
	  provide sysfs for factory test.
	  request selftest to adsp_factory.
	  receive test result from adsp_factory.

config LPS22DF_FACTORY
	bool "factory test for SSC - lps22df"
    depends on ADSP_FACTORY
	help
	  lps22df factory driver.
	  provide sysfs for factory test.
	  request selftest to adsp_factory.
	  receive test result from adsp_factory.

config PRESSURE_FACTORY
	bool "factory test for SSC - pressure"
    depends on ADSP_FACTORY
	help
	  pressure factory driver.
	  provide sysfs for factory test.
	  request selftest to adsp_factory.
	  receive test result from adsp_factory.

config LIGHT_FACTORY
	bool "factory test for SSC - light"
    depends on ADSP_FACTORY
	help
	  light factory driver.
	  provide sysfs for factory test.
	  request selftest to adsp_factory.
	  receive test result from adsp_factory.

config LIGHT_SUB_FACTORY
	bool "factory test for SSC - light sub"
    depends on ADSP_FACTORY
	help
	  light sub factory driver.
	  provide sysfs for factory test.
	  request selftest to adsp_factory.
	  receive test result from adsp_factory.

config PROX_FACTORY
	bool "factory test for SSC - prox"
    depends on ADSP_FACTORY
	help
	  prox factory driver.
	  provide sysfs for factory test.
	  request selftest to adsp_factory.
	  receive test result from adsp_factory.

config STK33610_FACTORY
	bool "factory test for SSC - STK33610"
	depends on ADSP_FACTORY
	help
	  stk33610 factory driver.
	  provide sysfs for factory test.
	  request selftest through factory daemon to slpi.
	  receive test result through factory daemon from slpi.

config STK33610_SUB_FACTORY
	bool "factory test for SSC - STK33610"
	depends on ADSP_FACTORY
	help
	  stk33610 factory driver.
	  provide sysfs for factory test.
	  request selftest through factory daemon to slpi.
	  receive test result through factory daemon from slpi.

config SUPPORT_LIGHT_CALIBRATION
	bool "light cal for SSC"
    depends on ADSP_FACTORY
	help
	  light calibration feature.
	  provide sysfs for light calibration.
	  request light cal to adsp_factory.
	  receive cal value from adsp_factory.

config SUPPORT_PROX_CALIBRATION
	bool "prox cal for SSC"
    depends on ADSP_FACTORY
	help
	  prox calibration feature.
	  provide sysfs for prox calibration.
	  request prox cal to adsp_factory.
	  receive cal value from adsp_factory.

config SUPPORT_CONTROL_PROX_LED_GPIO
	bool "control prox led gpio for SSC"
	depends on ADSP_FACTORY
	help
	  Support to control prox led gpio.

config SUPPORT_PROX_POWER_ON_CAL
	bool "Sensors support proximity sensor power on cal"
    depends on ADSP_FACTORY
	help
	  Support power on calibration for proximity sensor
	  make calibration process done as the device power up.

config SUPPORT_BRIGHTNESS_NOTIFY_FOR_LIGHT_SENSOR
	bool "Sensors support brightness notify"
    depends on ADSP_FACTORY
	help
	  Support brightness notify for light sensor.
	  receive aor and brightness level from lcd driver.

config SUPPORT_PANEL_STATE_NOTIFY_FOR_LIGHT_SENSOR
	bool "Sensors support panel state notify"
    depends on ADSP_FACTORY
	help
	  Support panel state notify for light sensor.
	  receive  panel state from lcd driver.

config SUPPORT_DDI_COPR_FOR_LIGHT_SENSOR
	bool "Sensors support ddi copr"
    depends on ADSP_FACTORY
	help
	  Support ddi copr for light sensor.
	  provide copr sysfs for factory and afc service.
	  DDI must be connected with sensor core

config SUPPORT_AP_COPR_FOR_LIGHT_SENSOR
	bool "Sensors support ap copr"
    depends on ADSP_FACTORY
	help
	  Support ap copr for light sensor.
	  provide copr sysfs for factory and afc service.
	  The display driver must provide copr data as notify.

config SUPPORT_DUAL_DDI_COPR_FOR_LIGHT_SENSOR
	bool "Sensors support dual ddi copr"
    depends on ADSP_FACTORY
	help
	  Support dual ddi copr for light sensor.
	  provide copr sysfs for factory and afc service.
	  DDI must be connected with sensor core

config SUPPORT_DUAL_6AXIS
	bool "Sensors support dual 6axis"
    depends on ADSP_FACTORY
	help
	  Support the dual accel and gyro function. 
	  provide sysfs for factory test.
	  request selftest to adsp_factory.
	  receive test result from adsp_factory.

config SUPPORT_TRIPLE_6AXIS
	bool "Sensors support triple 6axis"
    depends on ADSP_FACTORY
	help
	  Support the triple accel and gyro function. 
	  provide sysfs for factory test.
	  request selftest to adsp_factory.
	  receive test result from adsp_factory.

config SUPPORT_DUAL_MAG
	bool "Sensors support dual magnetic sensors"
    depends on ADSP_FACTORY
	help
	  Support the dual mag function. 
	  provide sysfs for factory test.
	  request selftest to adsp_factory.
	  receive test result from adsp_factory.

config SUPPORT_DUAL_OPTIC
	bool "Sensors support dual optic"
    depends on ADSP_FACTORY
	help
	  Support the dual prox and light function. 
	  provide sysfs for factory test.
	  request selftest to adsp_factory.
	  receive test result from adsp_factory.

config SUPPORT_VIRTUAL_OPTIC
	bool "Sensors support virtual optic"
    depends on ADSP_FACTORY
	help
	  Support the virtual prox and light function. 
	  provide sysfs for factory test.
	  request selftest to adsp_factory.
	  receive test result from adsp_factory.

config SUPPORT_DUAL_OPTIC_BUT_SUPPORT_SINGLE_PROX
	bool "Sensors support virtual optic but support single prox"
    depends on ADSP_FACTORY
	help
	  Support the virtual prox and light function. 
	  provide sysfs for factory test.
	  request selftest to adsp_factory.
	  receive test result from adsp_factory.

config SUPPORT_SENSOR_FLIP_MODEL
	bool "Sensors support sensor flip model"
	depends on ADSP_FACTORY
	help
	  Support sensor flip model. 
	  Separate the flip model from the factory test.

config SUPPORT_AK09973
	bool "Support ak09973"
    depends on ADSP_FACTORY
	help
	  Support ak09973.

config SUPPORT_DHALL_SWITCH
	bool "Support DHALL_SWITCH"
    depends on ADSP_FACTORY
	help
	  Support ak09973.

config SUPPORT_DEVICE_MODE
	bool "Support device mode"
    depends on ADSP_FACTORY
	help
	  Support device mode.

config SUPPORT_SENSOR_FOLD
	bool "Support fold state by sensor algorithm"
    depends on ADSP_FACTORY
	help
	  Support fold state by sensor algorithm.

config VEML3235_FACTORY
	bool "factory test for SSC - veml3235"
	depends on ADSP_FACTORY
	help
	  veml3235 factory driver.
	  provide sysfs for factory test.
	  request selftest to adsp_factory.
	  receive test result from adsp_factory.

config VEML3235_SUB_FACTORY
	bool "factory test for SSC - veml3235_sub"
	depends on ADSP_FACTORY
	help
	  veml3235_sub factory driver.
	  provide sysfs for factory test.
	  request selftest to adsp_factory.
	  receive test result from adsp_factory.

config VEML3328_FACTORY
	bool "factory test for SSC - veml3328"
	depends on ADSP_FACTORY
	help
	  veml3328 factory driver.
	  provide sysfs for factory test.
	  request selftest to adsp_factory.
	  receive test result from adsp_factory.

config VEML3328_SUB_FACTORY
	bool "factory test for SSC - veml3328_sub"
	depends on ADSP_FACTORY
	help
	  veml3328_sub factory driver.
	  provide sysfs for factory test.
	  request selftest to adsp_factory.
	  receive test result from adsp_factory.

config SUPPORT_LIGHT_SEAMLESS
	bool "Support Light seamless"
    depends on ADSP_FACTORY
	help
	  Support Light seamless.

config BACKTAP_FACTORY
	bool "factory test for SSC - Back Tap Sensor"
	depends on ADSP_FACTORY
	help
	  backtap factory driver.
	  provide sysfs for setting back tap peak threshold

config FLIP_COVER_DETECTOR_FACTORY
	bool "factory test for SSC - Flip Cover Detector"
	depends on ADSP_FACTORY
	help
	  flip_cover_detector factory driver.
	  provide sysfs for cover status by nfc

config FLIP_COVER_DETECTOR_NOTIFIER
	bool "flip cover detector notifier"
	depends on FLIP_COVER_DETECTOR_FACTORY
	default y
	help
	  Support notifier for flip cover attach/detach events

config SSC_WAKEUP_DEBUG
	bool "debug to ap wakeup due to SSC"
	depends on SEC_SENSORS_SSC
	help
	  debug to ap wakeup due to SSC event frequently

config SLPI_LOADING_FAILURE_DEBUG
	bool "debug to slpi loading fail"
	depends on SEC_SENSORS_SSC
	help
	  debug to to slpi loading fail

config SUPPORT_REF_ANGLE_WITHOUT_DIGITAL_HALL
	bool "support ref angle without digital hall"
	depends on ADSP_FACTORY
	help
	  support ref angle without digital hall

config SENSOR_FACTORY_KUNIT_FOR_ON_DEVICE
	tristate "KUnit test for sensor factory kunit"
	depends on SEC_KUNIT
	depends on ADSP_FACTORY

config SENSOR_FACTORY_KUNIT_FOR_ONLY_UML
	tristate "KUnit test for sensor factory kunit"
	depends on SEC_KUNIT
	depends on UML
	depends on ADSP_FACTORY

config AK09973_DIGITAL_HALL_TEST_FOR_ON_DEVICE
	tristate "KUnit test for ak09973_digital_hall_test"
	depends on SEC_KUNIT
	depends on SUPPORT_AK09973
	help
	  TODO: Describe config fully.
	  If you run this test driver on device, SHOULD set this config as 'm' to build test driver modulraly.

config AK09973_DIGITAL_HALL_TEST_FOR_ONLY_UML
	tristate "KUnit test for ak09973_digital_hall_test"
	depends on SEC_KUNIT
	depends on UML
	depends on SUPPORT_AK09973
	help
	  TODO: Describe config fully.
	  This CONFIG is recommended to set to y.

config SEC_SENSORS_RECOVERY
	bool "recovery slpi or adsp for sensor"
	depends on SEC_SENSORS_SSC
	help
	  recovery to slpi or adsp for sensor
```

## drivers/battery/charger/sm5443_charger/Kconfig
```kconfig
config CHARGER_SM5443
	tristate "SM5443 charger driver"
	default n
	depends on DIRECT_CHARGING
	help
	  Say Y or M here,
	  to enable support for the SM5443 charger.
	  This is 2:1 switched capacitor direct charger.
	  To compile the driver as a module, choose M here.
```

## drivers/battery/core/Kconfig
```kconfig
#
# SB Core
#

menu "SB Core configs"

config SB_CORE
	tristate "sb-core"
	default n
	help
	  Say Y here to enable.
	  support for sec battery core API.
	  (module: pq/notify/sysfs/vote)
	  refer to API headers.

config SB_PQUEUE
	bool "sb-pqueue"
	default n
	help
	  Say Y here to enable.
	  support for priority queue.
	  (api: push/pop/remove)
	  If you use the data type,
	  you should set the compare function.
	  refer to sb_pqueue.h

config SB_NOTIFY
	bool "sb-notify"
	default n
	help
	  Say Y here to enable.
	  support for notifier.
	  (type: probe/exit/external/others event)
	  refer to sb_notify.h

config SB_SYSFS
	bool "sb-sysfs"
	default n
	depends on SYSFS
	help
	  Say Y here to enable.
	  support for common sysfs.
	  If you want to make sysfs node in battery folder,
	  please use this API to work.
	  refer to sb_sysfs.h

config SB_VOTE
	bool "sb-vote"
	default n
	depends on SB_PQUEUE
	help
	  Say Y here to enable.
	  support for vote.
	  (set/get/find)
	  refer to sb_voter.h

config SB_PQUEUE_TEST
	tristate "KUnit test for sb_pqueue_test"
	depends on SEC_KUNIT
	help
    	  Say Y here to enable
	  support to kunit test.
	  for kunitest
          for sb_pqueue_test

config SB_NOTIFY_TEST
	tristate "KUnit test for sb_notify_test"
	depends on SEC_KUNIT
	help
    	  Say Y here to enable
	  support to kunit test.
	  for kunitest
          for sb_notify_test

config SB_SYSFS_TEST
	tristate "KUnit test for sb_sysfs_test"
	depends on SEC_KUNIT
	help
    	  Say Y here to enable
	  support to kunit test.
	  for kunitest
          for sb_sysfs_test

config SB_VOTE_TEST
	tristate "KUnit test for sb_vote_test"
	depends on SEC_KUNIT
	help
    	  Say Y here to enable
	  support to kunit test.
	  for kunitest
          for sb_vote_test

endmenu
```
