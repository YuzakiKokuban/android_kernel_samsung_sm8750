## drivers/samsung/debug/arm64/ap_context/Kconfig
```kconfig
config SEC_ARM64_AP_CONTEXT
	tristate "SEC AP CORE/MMU context snaphot"
	depends on SEC_DEBUG_REGION && ARM64 && ANDROID_VENDOR_HOOKS
	help
	  TODO: help is not ready.
```

## drivers/samsung/debug/arm64/debug/Kconfig
```kconfig
config SEC_ARM64_DEBUG
	tristate "SEC Common debugging feature for ARM64 based devices"
	depends on ARM64
	help
	  TODO: help is not ready.
```

## drivers/samsung/debug/boot_stat/Kconfig
```kconfig
config SEC_BOOT_STAT
	tristate "SEC Boot-stat driver"
	help
	  TODO: help is not ready.

config SEC_BOOT_STAT_TEST_FOR_ON_DEVICE
	tristate "KUnit test for sec_boot_stat_test"
	depends on KUNIT
	depends on SEC_BOOT_STAT
	help
	  TODO: Describe config fully.
	  If you run this test driver on device, SHOULD set this config as 'm' to build test driver modulraly.

config SEC_BOOT_STAT_TEST_FOR_ONLY_UML
	tristate "KUnit test for sec_boot_stat_test"
	depends on KUNIT
	depends on SEC_BOOT_STAT
	depends on UML
	help
	  TODO: Describe config fully.
	  This CONFIG is recommended to set to y.
```

## drivers/samsung/debug/debug_region/Kconfig
```kconfig
config SEC_DEBUG_REGION
	tristate "SEC Memory pool for debugging features"
	select GENERIC_ALLOCATOR
	help
	  TODO: help is not ready.
```

## drivers/samsung/debug/qcom/debug/Kconfig
```kconfig
config SEC_QC_DEBUG
	tristate "SEC Common debugging feature for Qualcomm based devices"
	help
	  TODO: help is not ready.

config SEC_QC_NR_CPUS
	int "Maximum number of CPUs for debugging features"
	range 2 8
	default "8"
```

## drivers/samsung/debug/qcom/hw_param/Kconfig
```kconfig
config SEC_QC_HW_PARAM
	tristate "SEC HW Paramter Driver for Qualcomm based devices"
	depends on SEC_QC_USER_RESET
	help
	  TODO: help is not ready.
```

## drivers/samsung/debug/qcom/mock/Kconfig
```kconfig
config SEC_QC_MOCK
	tristate "SEC Qualcomm Mock driver under QEMU based testing"
	default n
	help
	  TODO: help is not ready.
```

## drivers/samsung/debug/qcom/reboot_cmd/Kconfig
```kconfig
config SEC_QC_RBCMD
	tristate "SEC Reboot Commands for Qualcomm Based Devices"
	depends on SEC_REBOOT_CMD
	help
	  TODO: help is not ready.

config SEC_QC_RBCMD_TEST_FOR_ON_DEVICE
	tristate "KUnit test for sec_qc_rbcmd_main_test"
	depends on KUNIT
	depends on SEC_QC_RBCMD
	help
	  TODO: Describe config fully.
	  If you run this test driver on device, SHOULD set this config as 'm' to build test driver modulraly.

config SEC_QC_RBCMD_TEST_FOR_ONLY_UML
	tristate "KUnit test for sec_qc_rbcmd_main_test"
	depends on KUNIT
	depends on UML
	depends on SEC_QC_RBCMD
	help
	  TODO: Describe config fully.
	  This CONFIG is recommended to set to y.
```

## drivers/samsung/debug/qcom/upload_cause/Kconfig
```kconfig
config SEC_QC_UPLOAD_CAUSE
	tristate "SEC Panic Notifier Updating Upload Cause for Qualcomm Based Devices"
	depends on SEC_UPLOAD_CAUSE
	help
	  TODO: help is not ready.
```

## drivers/samsung/debug/qcom/user_reset/Kconfig
```kconfig
config SEC_QC_USER_RESET
	tristate "SEC User Reset Debug for Qualcomm based devices"
	depends on SEC_QC_DEBUG_PARTITION
	help
	  TODO: help is not ready.
```

## drivers/samsung/debug/qcom/wdt_core/Kconfig
```kconfig
config SEC_QC_QCOM_WDT_CORE
	tristate "SEC Additional feature for QTI Watchdog (QCOM_WDT_CORE)"
	depends on QCOM_WDT_CORE
	help
	  TODO: help is not ready.
```

## drivers/samsung/debug/rdx_bootdev/Kconfig
```kconfig
config SEC_RDX_BOOTDEV
	tristate "SEC RDX Boot-Dev driver for Samsung Android devices"
	help
	  TODO: help is not ready.
```

## drivers/samsung/debug/riscv64/debug/Kconfig
```kconfig
config SEC_RISCV64_DEBUG
	tristate "SEC Common debugging feature for RISCV64 based devices"
	depends on RISCV && 64BIT
	help
	  TODO: help is not ready.

config SEC_RISCV64_T32_CONSTANT
	bool "SEC debugging constants for Lauterbach T32"
	depends on SEC_RISCV64_DEBUG
	default n
	help
	  TODO: help is not ready.
```

## drivers/sdp/Kconfig
```kconfig
#
# samsung display platform
#

config SDP
	tristate "Samsung Display Platform"
	help
	  Samsung Display Platform.

config ADAPTIVE_MIPI_V2_TEST_FOR_ON_DEVICE
	tristate "KUnit test for adaptive_mipi_v2_test"
	depends on KUNIT
	depends on SDP
	help
	  TODO: Describe config fully.
	  If you run this test driver on device, SHOULD set this config as 'm' to build test driver modulraly.

config ADAPTIVE_MIPI_V2_TEST_FOR_ONLY_UML
	tristate "KUnit test for adaptive_mipi_v2_test"
	depends on KUNIT
	depends on UML
	depends on SDP
	help
	  TODO: Describe config fully.
	  This CONFIG is recommended to set to y.
```

## drivers/secdp/Kconfig
```kconfig
config SEC_DISPLAYPORT
	tristate "SEC DISPLAYPORT feature"
	default n
	help
	   Samsung specific displayport changes.
```

## drivers/sensors/vl53l8/Kconfig
```kconfig
# SPDX-License-Identifier: GPL-2.0-only


config SENSORS_VL53L8
	depends on SPI
	tristate "VL53L8 driver"
	default n
	help
	  Say Y here if you use VL53L5.
	  This option enables range sensor using VL53L8.

config SENSORS_VL53L8_SUPPORT_UAPI
	tristate "STM VL53L8 ranging sensor UPAI interface"
	default n
	help
	  STM VL53L8 ranging sensor UPAI interface.

config SENSORS_VL53L8_SUPPORT_KERNEL_INTERFACE
	tristate "STM VL53L8 ranging sensor Kernel Interface"
	default n
	help
	  STM VL53L8 ranging sensor Kernel Interface.

config SENSORS_VL53L8_QCOM
	tristate "VL53L8 ranging sensor feature for Snapdragon"
	default n
	help
	  VL53L8 ranging sensor feature for Snapdragon AP.

config SENSORS_VL53L8_SLSI
	tristate "VL53L8 ranging sensor feature for Exynos"
	default n
	help
	  VL53L8 ranging sensor feature for Exynos AP.

config SEPARATE_IO_CORE_POWER
	tristate "VL53L8 ranging sensor feature for IO/CORE Power source"
	default n
	help
	  This option enables IO and CORE power separation.

config SENSORS_LAF_FAILURE_DEBUG
	tristate "VL53L8 error code collection"
	default n
	help
	  This option enables error code collection.

config SENSORS_VL53L8_SUPPORT_RESUME_WORK
	tristate "VL53L8 work func to reduce resume time"
	default n
	help
	  VL53L8 ranging sensor feature to reduce resume time.
```

## drivers/staging/samsung/Kconfig
```kconfig
# SPDX-License-Identifier: GPL-2.0
menu "SAMSUNG OGKI debugging features"

source "drivers/staging/samsung/fat_common/Kconfig"

endmenu # SAMSUNG_MX
```

## drivers/staging/samsung/fat_common/Kconfig
```kconfig
# SPDX-License-Identifier: GPL-2.0
config FAT_COMMON
	bool "Enable common functions for external filesystems"
	default y
	help
	  This module provides common interface to support an external
	  filesystem. And module build is not supported because fat and
	  exfat are used as a built-in module in GKI. If you want to use
	  features in this module, then you must say Y.

config FS_COMMON_STLOG
	bool "Enable storage log helper functions"
	default y
	depends on FAT_COMMON && PROC_STLOG
	help
	  This feature provides common storage log helper functions.
	  Basically, it adds device major and minor number as prefix into
	  an original log message. If you want to use this help functions,
	  then you must say Y.

config FS_RO_UEVENT
	bool "Enable uevents for an external filesystem read-only remount"
	default y
	depends on FAT_COMMON
	help
	  This feature provides common uevent interface to notify that an
	  external filesystem has been set as read-only by an error. It
	  creates /sys/fs/fat/uevent observed by volume-daemon in Android
	  system. If you want to notify read-only remount uevent, then
	  you muset say Y.
```

## drivers/sti/abc/Kconfig
```kconfig
comment "Samsung ABC Options"
config SEC_ABC
	tristate "Samsung ABC Feature"
	depends on SEC_STI
	default n
	help
	  Samsung ABC(Abnormal Behavior Catcher) Driver Feature
	  This driver is to catch abnormal behavior in each device drivers
	  It depends on SEC_STI Feature

comment "Samsung ABC Common Options"
config SEC_ABC_COMMON
	tristate "Samsung ABC COMMON Feature"
	depends on SEC_ABC
	default n
	help
	  Samsung ABC(Abnormal Behavior Catcher) Driver Common Feature
	  This config is for ABC Driver Core Code
	  It depends on SEC_ABC Feature

comment "Samsung ABC Spec manager type1 options"
config SEC_ABC_SPEC_TYPE1
	tristate "Samsung ABC_SPEC_TYPE1 Feature"
	depends on SEC_ABC
	default n
	help
	  Samsung ABC(Abnormal Behavior Catcher)Driver's Spec manager type1 Feature
	  It has logic and spec of judgment of error type1.
	  It depends on SEC_ABC Feature

comment "Samsung ABC MOTTO Options"
config SEC_ABC_MOTTO
	tristate "Samsung ABC MOTTO Feature"
	depends on SEC_ABC
	default n
	help
	  Samsung ABC(Abnormal Behavior Catcher) MOTTO Function Feature
	  This config is to support MOTTO Function
	  It depends on SEC_ABC Feature

comment "Samsung ABC_COMMON KUNIT Options"
config SEC_ABC_COMMON_KUNIT
	tristate "Samsung ABC_COMMON KUNIT Feature"
	depends on SEC_ABC && SEC_KUNIT
	default n
	help
	  Samsung ABC(Abnormal Behavior Catcher) KUNIT Function Feature
	  This config is to support ABC_COMMON KUNIT Function
	  It depends on SEC_ABC && SEC_KUNIT Feature

comment "Samsung ABC Hub Options"
config SEC_ABC_HUB
	tristate "Samsung ABC Hub Feature"
	depends on SEC_ABC
	default n
	help
	  Samsung ABC(Abnormal Behavior Catcher) Hub Driver Feature
	  This config controls ABC Hub driver which supports ABC Driver
	  And it consists of abc_hub_core & abc_hub_cond & abc_hub_bootc.
	  It depends on SEC_ABC Feature

comment "Samsung ABC Hub Core Options"
config SEC_ABC_HUB_CORE
	tristate "Samsung ABC Hub Core Feature"
	depends on SEC_ABC_HUB
	default n
	help
	  Samsung ABC(Abnormal Behavior Catcher) Hub Driver's Core Feature
	  This function controls sub modules for supporting ABC Driver
	  It depends on SEC_ABC_HUB Feature

comment "Samsung ABC Hub Booting Time Check Options"
config SEC_ABC_HUB_BOOTC
	tristate "Samsung ABC Hub Booting Time Check Feature"
	depends on SEC_ABC_HUB
	default n
	help
	  Samsung BOOTC(Booting Time Check) Feature
	  This function is to check booting time
	  It is sub module of ABC Hub Driver
	  It depends on SEC_ABC_HUB Feature

comment "Samsung ABC Hub Booting Time Check eng mode Options"
config SEC_ABC_HUB_BOOTC_ENG
	tristate "Samsung ABC Hub Booting Time Check eng mode Feature"
	depends on SEC_ABC_HUB_BOOTC
	default n
	help
	  Samsung BOOTC(Booting Time Check) eng mode Feature
	  This function is to apply eng binary booting time spec
	  It depends on SEC_ABC_HUB_BOOTC Feature

comment "Samsung ABC_HUB KUNIT Options"
config SEC_ABC_HUB_KUNIT
	tristate "Samsung ABC_HUB KUNIT Feature"
	depends on SEC_ABC_HUB && SEC_KUNIT
	default n
	help
	  Samsung ABC(Abnormal Behavior Catcher) Hub KUNIT Function Feature
	  This config is to support ABC Hub KUNIT Function
	  It depends on SEC_ABC_HUB && SEC_KUNIT Feature

comment "Samsung ABC Hub Connect Detect for ABC HUB"
config SEC_ABC_HUB_COND
	tristate "Samsung ABC Hub Connect Detect Feature"
	depends on SEC_ABC_HUB
	help
	  Samsung COND(Connect Detect) Feature
	  This function is to detect connect h/w problem
	  It is sub module of ABC Hub Driver
	  It depends on SEC_ABC_HUB Feature

comment "Samsung ABC Hub Connect Detect Kunit Test FEATURE"
config SEC_ABC_DETECT_KUNIT
	tristate "Samsung Connector Detector Kunit TEST"
	help
		Feature for checking connector detection code .
		This feature should be enabled only for testing while development.

comment "Samsung ABC Hub Connect Detect FEATURE"
config SEC_ABC_DETECT_CONN
	tristate "Samsung Connector Detector feature"
	help
		Feature for checking connector status.
		This feature should be enabled in factory mode.

comment "Samsung ABC Hub Connect Detect for QCOM, MTK"
config QCOM_SEC_ABC_DETECT
	tristate "Samsung Connector Detector Qcom feature"
	help
		Feature for checking QCOM Chipset.
		This feature should be enabled for QCOM chipset in factory mode.
```

## drivers/usb/typec/common/Kconfig
```kconfig
#
# USB PDIC common driver
#

comment "USB PDIC common configs"

config PDIC_NOTIFIER
	tristate "PDIC notifier support"
	depends on I2C
	default n
	help
	  If you say yes here you will get support for
	  the PDIC attached device status change notification.

config PDIC_POLICY
	bool "PDIC policy common"
	default n
	help
	  If you want to use common policy api,
	  enable this feature.
	  It should not be enabled in previos ic driver.
	  Use to bringup new ic driver.

config USB_ARCH_EXYNOS
	bool "Using exynos"
	default n
	help
	  If you say yes here you will get support for
	  using exynos.
	  For distinguish with Qcom

config PDIC_USE_MODULE_PARAM
	bool "Using module param"
	depends on PDIC_NOTIFIER
	default n
	help
	  If this feature is enabled, pdic_param will use module_param directly.
	  Should not use extern variable and __setup for param.
	  need to add cmdline in bootloader.
	  (ex: pdic_notifier_module.xxx)

config PDIC_MISC_TEST
        bool "KUnit test for pdic_misc_test"
        depends on SEC_KUNIT
        help
          This driver is for pdic_misc test driver
		  pdic_misc kunit test
		  If you want to add some functions,
		  Please make the test case.

config PDIC_SYSFS_TEST
        bool "KUnit test for pdic_sysfs_test"
        depends on SEC_KUNIT
        help
          This driver is for pdic_sysfs test driver
		  pdic_sysfs kunit test
		  If you want to add some functions,
		  Please make the test case.
```

## drivers/usb/typec/manager/Kconfig
```kconfig
#
# USB TypeC Manager driver
#

comment "USB TypeC Manager configs"

config USB_TYPEC_MANAGER_NOTIFIER
    tristate "USB TypeC Manager driver"
    help
    If you say yes here you will get support for
      USB TypeC Manager function

config IF_CB_MANAGER
    tristate "IF CallBack function Manager"
    default n
    help
    If you say yes here you will use if_cb_manager structure
    that makes functions to callback functions

config USB_TYPEC_MANAGER_NOTIFIER_TEST
        tristate "KUnit test for usb_typec_manager_notifier_test"
        depends on SEC_KUNIT
        depends on USB_TYPEC_MANAGER_NOTIFIER
        default y

        help
          TODO: Describe config fully.

config SBU_SWITCH_CONTROL
    bool "Support controlling SBU switch open/close"
    depends on IF_CB_MANAGER
    default n
    help
        If you say yes here you will use if_cb_manager function
        to control SBU switch (controlled by displayport TG)
        This config indicates that switch will be controlled
        manually by drivers, not automatically by FW or HW.
```
