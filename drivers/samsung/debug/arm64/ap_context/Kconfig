## drivers/usb/typec/maxim/Kconfig
```kconfig
#
# CCIC devices
#

comment "CCIC configs"

config CCIC_MAX77775
	tristate "CCIC 77775"
	depends on I2C
	default n
	help
	  If you say yes here you will get support for
	  max77775 ccic full version chipset

config MAX77775_CCIC_ALTERNATE_MODE
	bool "support alternate mode"
	depends on CCIC_MAX77775
	default n
	help
	  If you say yes here you will get support for
	  alternate mode function with max77775 ccic chipset

config MUIC_MAX77775
	tristate "Using MAX77775 MUIC"
	depends on USE_MUIC
	default n
	help
	  If you say yes here you will get support for
	  the MAX77775 MUIC chip.
	  To enable this driver,
	  USE_MUIC should be enabled.

config HV_MUIC_MAX77775_AFC
	tristate "Using MAX77775 AFC MUIC"
	default n
	help
	  If you say yes here you will get support for
	  the MAX77775 AFC MUIC.
	  To enable this driver,
	  MUIC_MAX77775 should be enabled.

config MAX77775_MUIC_QC_DISABLE
	bool "Using QC charging"
	depends on USE_MUIC
	default n
	help
	  If you say yes here you will not get support for the QC charging

config MAX77775_UPGRADED_WATER_DETECT
	bool "Using improved water detection"
	depends on CCIC_MAX77775
	default n
	help
	  If you say yes here you will get support for extra water detection
	  driver will check if it is water + no VBUS + no hiccup state,
	  and if the condition is satisfied, it will reset IC.

config MAX77775_GET_UNMASK_VBUS_HWPARAM
	bool "Using get unmask vbus hw param"
	depends on CCIC_MAX77775
	default n
	help
	  If you say yes here you will get support for getting unmask vbus hw param
	  driver will check if it is attach/detach repeat state,
	  and if the condition is satisfied, it will get the hw param.
	  
config MUIC_POGO_DISABLE_TYPEC
	bool "Using pogo disable typec"
	default n
	help
	  If you say yes here you will get support for disabling typec.
	  driver will disable the use of typec when pogo was connected.

config MAX77775_ALTERNATE_TEST_FOR_ON_DEVICE
	tristate "KUnit test for max77775_alternate_test"
	depends on KUNIT
	depends on CCIC_MAX77775
	help
	  This is feature for max77775_alternate.c file.
	  If you run this test driver on device, SHOULD set this config as 'm' to build test driver modulraly.

config MAX77775_ALTERNATE_TEST_FOR_ONLY_UML
	tristate "KUnit test for max77775_alternate_test"
	depends on KUNIT
	depends on UML
	depends on CCIC_MAX77775
	help
	  This is feature for max77775_alternate.c file. (UML)
	  This CONFIG is recommended to set to y.

config MAX77775_CCOPEN_AFTER_WATERCABLE
	bool "Using ccopen water detection"
	depends on CCIC_MAX77775
	default n
	help
	  If you say yes here you will get support for ccopen on water detection
	  cc line open if the water + cable is connected.
	  To protect the connector by completely blocking VBUS
```

## drivers/usb/vendor_notify/Kconfig
```kconfig
config USB_VENDOR_NOTIFY
	tristate "USB vendor notify"
	default n
	help
	 Say Y here to include support for USB vendor notify.

	 To compile this driver as a module, choose M here: the module
	 will be called usb-vendor-notify.


config USB_VENDOR_RECEIVER
	tristate "USB vendor receiver"
	default n
	depends on USB_NOTIFY_LAYER
	help
	 Say Y here to include support for USB vendor receiver.

	 To compile this driver as a module, choose M here: the module
	 will be called usb-vendor-receiver.
```

## drivers/uwb/Kconfig
```kconfig
#
# UWB device configuration
#
config SAMSUNG_UWB
	tristate "Samsung UWB driver"
	default n
	help
	  Say Y here if you want to build support for UWB devices.
	  To compile this support as a module, choose M here: the module will
	  be called uwb.

config UWB_SR200
	bool "Nxp SPI driver for SR200 devices"
	default n
	help
	  NXP SR200 UWB controller support.

config SEC_UWB_LOGGER
	bool "UWB logger"
	default n
	help
	  Enable UWB logger.

config ACPM_INIT
	bool "ACPM INIT"
	default n
	help
	  ACPM INIT must be called to use CLK4 in S5910.

config UWB_QM35
	bool "Qorvo SPI driver for QM35 devices"
	default n
	help
	  Qorvo QM35 UWB controller support.

config UWB_USE_CLK_REQ
	bool "USE CLK REQ for using PMIC clock"
	default n
	help
	  Use CLK REQ pin for using PMIC clock.
```

## drivers/vibrator/common/vib_info/Kconfig
```kconfig
config VIBRATOR_VIB_INFO
	tristate "The module for vibrator information"
	default n
	help
	  This module supports sysfs nodes for vibrator information.
	  supported functions are served for vibrator hal.
	  vibrator hal also can get intensities table by this module.
	  We recommend to use this module for all models.

config VIBRATOR_VIB_INFO_TEST
        bool "KUnit test for vibrator_vib_info_test"
        depends on SEC_KUNIT
        help
          This driver is for vibrator_vib_info_test driver
		  vibrator_vib_info_test kunit test
		  If you want to add some functions,
		  Please make the test case.
```
