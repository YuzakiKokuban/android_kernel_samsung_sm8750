// SPDX-License-Identifier: BSD-3-Clause
/*
 * Copyright (c) 2023-2024 Qualcomm Innovation Center, Inc. All rights reserved.
 */

#include "sun-gpu.dtsi"

&msm_gpu {
	compatible = "qcom,adreno-gpu-gen8-0-1", "qcom,kgsl-3d0";

	qcom,gpu-model = "Adreno830v2";

	qcom,chipid = <0x44050001>;
};
