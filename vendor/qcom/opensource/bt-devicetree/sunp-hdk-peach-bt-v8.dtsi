// SPDX-License-Identifier: BSD-3-Clause

/*
 * Copyright (c) 2024 Qualcomm Innovation Center, Inc. All rights reserved.
 */

#include "sun-peach-bt-v8.dtsi"

/delete-node/ &fm_rtc6226;

&bluetooth {
    /delete-property/ qcom,bt-ant-ldo-supply;
    /delete-property/ qcom,bt-ant-ldo-config;
};