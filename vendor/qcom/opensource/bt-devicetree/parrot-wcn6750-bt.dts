// SPDX-License-Identifier: BSD-3-Clause

/*
 * Copyright (c) 2024 Qualcomm Innovation Center, Inc. All rights reserved.
 */

/dts-v1/;
/plugin/;

#include "parrot-wcn6750-bt.dtsi"

/ {
	model = "Qualcomm Technologies, Inc. Parrot SoC";
	compatible = "qcom,parrot";
	qcom,msm-id = <537 0x10000>, <583 0x10000>, <613 0x10000>, <631 0x10000>, <633 0x10000>, <634 0x10000>, <638 0x10000>, <663 0x10000>;
	qcom,board-id = <34 0>, <34 2>, <34 4>, <34 5>, <34 6>, <34 0x600>, <34 0x602>, <34 0x604>, <0x1000B 1>, <0x1000B 2>, <0x1000B 0x601>;
};

