// SPDX-License-Identifier: BSD-3-Clause

/*
 * Copyright (c) 2024 Qualcomm Innovation Center, Inc. All rights reserved.
 */

&qupv3_se0_i2c {
	/*status = "ok";*/
	/*qcom,clk-freq-out = <1000000>;*/
	#address-cells = <1>;
	#size-cells = <0>;
	nq@28 {
		status = "disabled";
		compatible = "qcom,sn-nci";
		reg = <0x28>;
		qcom,sn-irq = <&tlmm 75 0x00>;
		qcom,sn-ven = <&tlmm 34 0x00>;
		qcom,sn-clkreq = <&tlmm 35 0x00>;
		qcom,sn-szone = "enable";
		interrupt-parent = <&tlmm>;
		interrupts = <75 0>;
		interrupt-names = "nfc_irq";
		pinctrl-names = "nfc_active", "nfc_suspend";
		pinctrl-0 = <&nfc_int_active &nfc_enable_active>;
		pinctrl-1 = <&nfc_int_suspend &nfc_enable_suspend>;
	};
};
