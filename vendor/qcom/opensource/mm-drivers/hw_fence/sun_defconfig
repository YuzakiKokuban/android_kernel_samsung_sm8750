## vendor/qcom/opensource/wlan/qcacld-3.0/configs/anorak_consolidate_kiwi-v2_defconfig
```kconfig
CONFIG_ATH_DIAG_EXT_DIRECT=y
CONFIG_DESC_TIMESTAMP_DEBUG_INFO=y
CONFIG_DSC_DEBUG=y
CONFIG_DSC_TEST=y
CONFIG_ENABLE_QDF_PTR_HASH_DEBUG=y
CONFIG_FEATURE_UNIT_TEST_SUSPEND=y
CONFIG_HAL_DEBUG=y
CONFIG_LEAK_DETECTION=y
CONFIG_MAX_LOGS_PER_SEC=500
CONFIG_ENABLE_MAX_LOGS_PER_SEC=y
CONFIG_REGISTER_OP_DEBUG=y
CONFIG_SCHED_HISTORY_SIZE=256
CONFIG_ENABLE_SCHED_HISTORY_SIZE=y
CONFIG_TALLOC_DEBUG=y
CONFIG_UNIT_TEST=y
CONFIG_QDF_TEST=y
CONFIG_DYNAMIC_DEBUG=y
CONFIG_FEATURE_WLM_STATS=y
CONFIG_WLAN_TRACE_HIDE_MAC_ADDRESS_DISABLE=y
```

## vendor/qcom/opensource/wlan/qcacld-3.0/configs/kiwi_v2_defconfig
```kconfig
CONFIG_CNSS_KIWI := y
CONFIG_CNSS_KIWI_V2 := y
CONFIG_INCLUDE_HAL_KIWI := y

ifeq ($(CONFIG_ARCH_SDXPINN), y)
CONFIG_MOBILE_ROUTER := y
CONFIG_WLAN_SYSFS := y
endif

include $(WLAN_ROOT)/configs/default_defconfig

#Enable 11BE EHT
CONFIG_WLAN_FEATURE_11BE := y

#Enable IPA Optional wifi datapath feature
ifeq ($(CONFIG_ARCH_PINEAPPLE), y)
CONFIG_IPA_OPT_WIFI_DP := y
CONFIG_IPA_OFFLOAD := y
CONFIG_ENABLE_SMMU_S1_TRANSLATION := y
CONFIG_SMMU_S1_UNMAP := y
endif

# Enable EHT rate sysfs entry
ifeq ($(CONFIG_WLAN_SYSFS), y)
CONFIG_WLAN_SYSFS_EHT_RATE := y
CONFIG_WLAN_SYSFS_BITRATES := y
endif

# Max Sta Vdev Config
CONFIG_CFG_MAX_STA_VDEVS := 4

#Enable 11BE MLO
CONFIG_WLAN_FEATURE_11BE_MLO := y

#Enable Single NDEV Multi VDEV
CONFIG_WLAN_HDD_MULTI_VDEV_SINGLE_NDEV := y

#BMISS offload max vdev config
CONFIG_CFG_BMISS_OFFLOAD_MAX_VDEV := 4

#Max MLD dev context
CONFIG_WLAN_UMAC_MLO_MAX_DEV := 3

#Chip version
CONFIG_CHIP_VERSION := 2

#DP configs
CONFIG_WLAN_DP_DISABLE_TCL_CMD_CRED_SRNG := y
CONFIG_WLAN_DP_DISABLE_TCL_STATUS_SRNG := y

# Enable separate FW image
CONFIG_GET_DRIVER_MODE := y

CONFIG_QCA_SUPPORT_TX_MIN_RATES_FOR_SPECIAL_FRAMES := y

#Enable COEX feature
CONFIG_FEATURE_COEX := y

#Enable DBAM feature
ifeq ($(CONFIG_FEATURE_COEX), y)
CONFIG_WLAN_FEATURE_COEX_DBAM := y
endif

CONFIG_DP_TRAFFIC_END_INDICATION := y

#Enable Constrained Application Protocol feature
CONFIG_WLAN_FEATURE_COAP := y

#Enable TSF read using scratch register
CONFIG_QCA_GET_TSF_VIA_REG := y

CONFIG_WLAN_FEATURE_AFFINITY_MGR := y

#Enable per link stats support
CONFIG_DP_MLO_LINK_STATS_SUPPORT := y

CONFIG_QCA_DFS_BW_PUNCTURE := y

ifeq ($(CONFIG_ARCH_SDXPINN), y)

CONFIG_DP_FEATURE_HW_COOKIE_CONVERSION := n
CONFIG_DP_HW_COOKIE_CONVERT_EXCEPTION := n
CONFIG_DP_MEM_PRE_ALLOC := n
CONFIG_MORE_TX_DESC := n

CONFIG_AFC_SUPPORT := y
CONFIG_WLAN_FEATURE_AFC_DCS_SKIP_ACS_RANGE := y

CONFIG_WIFI_MONITOR_SUPPORT := n
CONFIG_QCA_MONITOR_PKT_SUPPORT := n
CONFIG_MONITOR_MODULARIZED_ENABLE := y

CONFIG_QCACLD_FEATURE_NAN := n
CONFIG_FEATURE_EPPING := n
CONFIG_FEATURE_P2P_LISTEN_OFFLOAD := n
CONFIG_WLAN_CFR_ENABLE := n

CONFIG_MAX_CLIENTS_ALLOWED := 64

ifeq ($(CONFIG_QCACLD_FEATURE_SON), y)
CONFIG_WLAN_UMAC_MLO_MAX_DEV := 6
CONFIG_BEACON_TX_OFFLOAD_MAX_VDEV := 6
CONFIG_NUM_IPA_IFACE := 6
CONFIG_QDF_MAX_NO_OF_SAP_MODE := 6
else
CONFIG_WLAN_UMAC_MLO_MAX_DEV := 4
CONFIG_BEACON_TX_OFFLOAD_MAX_VDEV := 4
CONFIG_NUM_IPA_IFACE := 4
CONFIG_QDF_MAX_NO_OF_SAP_MODE := 4
endif

ifeq ($(CONFIG_IPA_OFFLOAD), y)
CONFIG_ENABLE_SMMU_S1_TRANSLATION := y
CONFIG_SMMU_S1_UNMAP := y
CONFIG_IPA_WDI3_TX_TWO_PIPES := y

ifeq ($(CONFIG_WLAN_FEATURE_11BE_MLO), y)
CONFIG_IPA_HANDLE_MLO_DEF_LINK_REG := y
endif # WLAN_FEATURE_11BE_MLO
endif # IPA_OFFLOAD

CONFIG_WLAN_SYSFS_RANGE_EXT := n

CONFIG_WLAN_FEATURE_RX_BUFFER_POOL := y
CONFIG_DP_RX_REFILL_BUFF_POOL_SIZE := 256
CONFIG_DP_RX_REFILL_THRD_THRESHOLD := 128

CONFIG_WLAN_FEATURE_COAP := n

endif # ARCH_SDXPINN

ifeq ($(CONFIG_ARCH_PINEAPPLE), y)
CONFIG_WLAN_TX_MON_2_0 := y
CONFIG_WLAN_DP_LOCAL_PKT_CAPTURE := y
endif

CONFIG_WLAN_FEATURE_LL_LT_SAP := y

CONFIG_WLAN_FEATURE_MULTI_LINK_SAP_TEST_CONFIG := y

CONFIG_DP_FTM_MODE_SKIP_WBM_RING_INIT := y
CONFIG_FEATURE_WLAN_SUPPORT_USD=y
```

## vendor/qcom/opensource/wlan/qcacld-3.0/configs/qca6490_defconfig
```kconfig
CONFIG_CNSS_QCA6490 := y
include $(WLAN_ROOT)/configs/default_defconfig
ifeq ($(CONFIG_WLAN_FOR_AUTO_GVM), y)
CONFIG_HIF_CPU_PERF_AFFINE_MASK := n
endif

CONFIG_FOURTH_CONNECTION_AUTO := y
```

## vendor/qcom/opensource/wlan/qcacld-3.0/configs/qca6750_defconfig
```kconfig
CONFIG_CNSS_QCA6750 := y
$(warning "### DBG CONFIG_CNSS_QCA6750")
include $(WLAN_ROOT)/configs/default_defconfig

CONFIG_FEATURE_WLAN_CH_AVOID_EXT := y
```
