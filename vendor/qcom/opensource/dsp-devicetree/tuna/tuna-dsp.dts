// SPDX-License-Identifier: BSD-3-Clause
/*
 * Copyright (c) 2024 Qualcomm Innovation Center, Inc. All rights reserved.
 */

/dts-v1/;
/plugin/;

#include "tuna-dsp.dtsi"

/ {
	model = "Qualcomm Technologies, Inc. Tuna v1 SoC";
	compatible = "qcom,tuna";
	qcom,msm-id = <655 0x10000>;
	qcom,board-id = <0 0>;
};
