// SPDX-License-Identifier: BSD-3-Clause
/*
 * Copyright (c) 2024 Qualcomm Innovation Center, Inc. All rights reserved.
 */

/dts-v1/;
/plugin/;

#include "tuna-dsp-trustedvm.dtsi"

/ {
	model = "Qualcomm Technologies, Inc. Tuna - TrustedVM";
	compatible = "qcom,tuna";
	qcom,msm-id = <655 0x10000>;
};
