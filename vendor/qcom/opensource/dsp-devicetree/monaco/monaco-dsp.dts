/* SPDX-License-Identifier: BSD-3-Clause
 * Copyright (c) 2024 Qualcomm Innovation Center, Inc. All rights reserved.
 */

/dts-v1/;
/plugin/;

#include "monaco-dsp.dtsi"

/ {
	model = "Qualcomm Technologies, Inc. Monaco SoC";
	compatible = "qcom,monaco";
	qcom,msm-id = <486 0x10000>, <517 0x10000>;
	qcom,board-id = <0 0>;
};
