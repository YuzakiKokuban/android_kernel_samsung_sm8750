/dts-v1/;
/plugin/;

#include <dt-bindings/interrupt-controller/arm-gic.h>
#include <dt-bindings/soc/qcom,ipcc.h>
#include <dt-bindings/interconnect/qcom,pineapple.h>
#include <dt-bindings/clock/qcom,videocc-pineapple.h>
#include <dt-bindings/clock/qcom,gcc-pineapple.h>
#include "pineapple-dsp.dtsi"

/ {
	model = "Qualcomm Technologies, Inc. pineapple v1 SoC";
	compatible = "qcom,pineapple";
	qcom,board-id = <0 0>;
};
