// SPDX-License-Identifier: BSD-3-Clause
/*
 * Copyright (c) 2024 Qualcomm Innovation Center, Inc. All rights reserved.
 */

/dts-v1/;
/plugin/;

#include "kera-dsp.dtsi"

/ {
	model = "Qualcomm Technologies, Inc. Kera v1 SoC";
	compatible = "qcom,kera";
	qcom,msm-id = <659 0x10000>;
	qcom,board-id = <0 0>;
};
