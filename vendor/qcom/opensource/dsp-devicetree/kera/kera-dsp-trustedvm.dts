// SPDX-License-Identifier: BSD-3-Clause
/*
 * Copyright (c) 2024 Qualcomm Innovation Center, Inc. All rights reserved.
 */

/dts-v1/;
/plugin/;

#include "kera-dsp-trustedvm.dtsi"

/ {
	model = "Qualcomm Technologies, Inc. Kera - TrustedVM";
	compatible = "qcom,kera";
	qcom,msm-id = <659 0x10000>;
};
