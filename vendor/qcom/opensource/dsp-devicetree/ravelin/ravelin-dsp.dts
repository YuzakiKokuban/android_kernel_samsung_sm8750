// SPDX-License-Identifier: BSD-3-Clause
/*
 * Copyright (c) 2024 Qualcomm Innovation Center, Inc. All rights reserved.
 */
/dts-v1/;
/plugin/;

#include "ravelin-dsp.dtsi"

/ {
	model = "Qualcomm Technologies, Inc. ravelin v1 SoC";
	compatible = "qcom,ravelin";
	qcom,msm-id = <568 0x10000>, <602 0x10000>, <654 0x10000>, <653 0x10000>;
	qcom,board-id = <0 0>;
};
