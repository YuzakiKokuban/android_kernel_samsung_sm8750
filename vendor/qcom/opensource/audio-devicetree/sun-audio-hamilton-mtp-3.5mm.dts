// SPDX-License-Identifier: BSD-3-Clause
/*
 * Copyright (c) 2024 Qualcomm Innovation Center, Inc. All rights reserved.
 */

/dts-v1/;
/plugin/;

/*This is MTP with Hamilton + V8 + 3.5mm support*/

#include "sun-audio-hamilton-mtp-3.5mm.dtsi"

/ {
	model = "Qualcomm Technologies, Inc. Sun MTP Hamilton with 3.5mm";
	compatible = "qcom,sun-mtp", "qcom,sun", "qcom,sunp-mtp", "qcom,sunp",
		"qcom,mtp";
	qcom,msm-id = <618 0x10000>, <618 0x20000>, <639 0x10000>, <639 0x20000>,
		<0x100026a 0x10000>, <0x100026a 0x20000>,
		<0x100027f 0x10000>, <0x100027f 0x20000>;
	qcom,board-id = <0x60108 0>;
};

