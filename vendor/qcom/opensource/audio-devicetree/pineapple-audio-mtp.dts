// SPDX-License-Identifier: BSD-3-Clause
/*
 * Copyright (c) 2023 Qualcomm Innovation Center, Inc. All rights reserved.
 */

/dts-v1/;
/plugin/;

#include "pineapple-audio-mtp.dtsi"
 / {
	model = "Qualcomm Technologies, Inc. Pineapple MTP";
	compatible = "qcom,pineapple-mtp", "qcom,pineapple", "qcom,mtp";
	qcom,msm-id = <557 0x10000>, <557 0x20000>, <577 0x10000>, <577 0x20000>;
	qcom,board-id = <8 0>;
};
