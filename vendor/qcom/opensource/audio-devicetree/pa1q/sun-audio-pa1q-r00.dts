// SPDX-License-Identifier: BSD-3-Clause
/*
 * Copyright (c) 2023-2024 Qualcomm Innovation Center, Inc. All rights reserved.
 */

/dts-v1/;
/plugin/;

#include "../sun-audio-mtp.dtsi"
#include "../sun-sec-paradigm-audio-pinctrl-common.dtsi"
#include "../sun-sec-paradigm-audio-common.dtsi"

/ {
	model = "Samsung PA1Q PROJECT (board-id,00)";
	compatible = "qcom,sun-mtp", "qcom,sun", "qcom,sunp-mtp", "qcom,sunp",
			   "qcom,mtp";
	qcom,msm-id = <618 0x10000>, <618 0x20000>, <639 0x10000>, <639 0x20000>,
		      <0x100026a 0x10000>, <0x100026a 0x20000>,
		      <0x100027f 0x10000>, <0x100027f 0x20000>;
	qcom,board-id = <8 0>;
};
