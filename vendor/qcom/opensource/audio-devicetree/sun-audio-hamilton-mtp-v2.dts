// SPDX-License-Identifier: BSD-3-Clause
/*
 * Copyright (c) 2024 Qualcomm Innovation Center, Inc. All rights reserved.
 */

/dts-v1/;
/plugin/;

/*This is MTP v2 with Hamilton + V8/V6 wlan*/

#include "sun-audio-hamilton-qmp-mtp.dtsi"

/ {
	model = "Qualcomm Technologies, Inc. Sun MTP ST54L NFC";
	compatible = "qcom,sun-mtp", "qcom,sun", "qcom,sunp-mtp", "qcom,sunp", "qcom,mtp";
	qcom,msm-id = <618 0x20000>, <639 0x20000>,
			<0x100026a 0x20000>,
			<0x100027f 0x20000>;
	qcom,board-id = <0x20008 0>, <0x50008 0>;
};

