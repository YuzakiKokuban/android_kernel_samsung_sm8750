// SPDX-License-Identifier: BSD-3-Clause
/*
 * Copyright (c) 2023 Qualcomm Innovation Center, Inc. All rights reserved.
 */

#include "pineapple-audio-qrd.dtsi"

&pineapple_snd {
	qcom,model = "pineapple-qrd-sku2-snd-card";
};

