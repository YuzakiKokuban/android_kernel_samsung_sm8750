// SPDX-License-Identifier: BSD-3-Clause
/*
 * Copyright (c) 2023 Qualcomm Innovation Center, Inc. All rights reserved.
 */

/dts-v1/;
/plugin/;

#include "sun-audio-rumi.dtsi"
 / {
	model = "Qualcomm Technologies, Inc. Sun RUMI";
	compatible = "qcom,sun-rumi", "qcom,sun", "qcom,rumi";
	qcom,msm-id = <618 0x10000>, <618 0x20000>, <639 0x10000>, <639 0x20000>,
			<0x100026a 0x10000>, <0x100026a 0x20000>,
			<0x100027f 0x10000>, <0x100027f 0x20000>;
	qcom,board-id = <15 0>;
};
