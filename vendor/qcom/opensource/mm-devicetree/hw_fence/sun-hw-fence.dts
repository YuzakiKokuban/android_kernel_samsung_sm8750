// SPDX-License-Identifier: BSD-3-Clause
/*
 * Copyright (c) 2023-2024 Qualcomm Innovation Center, Inc. All rights reserved.
 */

/dts-v1/;
/plugin/;

#include "sun-hw-fence.dtsi"

/ {
	model = "Qualcomm Technologies, Inc. Sun SoC";
	compatible = "qcom,sun";
	qcom,msm-id = <618 0x10000>, <618 0x20000>, <639 0x10000>, <639 0x20000>;
	qcom,board-id = <0 0>;
};
