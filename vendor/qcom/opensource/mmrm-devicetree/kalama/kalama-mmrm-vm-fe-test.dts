// SPDX-License-Identifier: BSD-3-Clause
/*
 * Copyright (c) 2024 Qualcomm Innovation Center, Inc. All rights reserved.
 */

/dts-v1/;
/plugin/;

#include <dt-bindings/clock/qcom,camcc-kalama.h>
#include <dt-bindings/clock/qcom,videocc-kalama.h>
#include <dt-bindings/clock/qcom,dispcc-kalama.h>

#include "kalama-mmrm-vm-fe-test.dtsi"

/ {
	model = "Qualcomm Technologies, Inc. Kalama";
	compatible = "qcom,kalama";
	qcom,msm-id = <519 0x10000>, <536 0x10000>;
	qcom,board-id = <0x10001 0>;
};
