// SPDX-License-Identifier: BSD-3-Clause
/*
 * Copyright (c) 2024 Qualcomm Innovation Center, Inc. All rights reserved.
 */

&soc {
	mmrm_vm_be: qcom,mmrm-vm-be {
		compatible = "qcom,mmrm-vm-be";
		status = "disable";
	};
};

