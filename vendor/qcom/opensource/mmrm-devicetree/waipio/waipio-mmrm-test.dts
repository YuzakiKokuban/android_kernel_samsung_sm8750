// SPDX-License-Identifier: BSD-3-Clause
/*
 * Copyright (c) 2024 Qualcomm Innovation Center, Inc. All rights reserved.
 */
/dts-v1/;
/plugin/;

#include <dt-bindings/clock/qcom,camcc-waipio.h>
#include <dt-bindings/clock/qcom,videocc-waipio.h>
#include <dt-bindings/clock/qcom,dispcc-waipio.h>
#include "waipio-mmrm-test.dtsi"

/ {
	model = "Qualcomm Technologies, Inc. waipio v1 & v2 SoC";
	compatible = "qcom,waipio";
	qcom,msm-id = <457 0x10000>, <482 0x10000>;
	qcom,board-id = <0 0>; /* required by merge_dtbs.py */
};
