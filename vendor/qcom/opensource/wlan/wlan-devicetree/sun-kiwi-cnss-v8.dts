// SPDX-License-Identifier: BSD-3-Clause

/*
 * Copyright (c) 2024 Qualcomm Innovation Center, Inc. All rights reserved.
 */

/dts-v1/;
/plugin/;

#include "sun-kiwi-cnss-v8.dtsi"

/ {
	model = "Qualcomm Technologies, Inc. Sun SoCs";
	compatible = "qcom,sun", "qcom,sunp";
	qcom,msm-id = <618 0x10000>, <618 0x20000>,
		      <639 0x10000>, <639 0x20000>;
	qcom,board-id = <0x60001 0>, <0x50008 0>, <0x20015 0>;
};
