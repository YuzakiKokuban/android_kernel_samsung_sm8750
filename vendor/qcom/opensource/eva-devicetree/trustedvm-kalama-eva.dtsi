// SPDX-License-Identifier: BSD-3-Clause
/*
 * Copyright (c) 2024 Qualcomm Innovation Center, Inc. All rights reserved.
 */

&soc {
	msm_cvp: qcom,cvp@ab00000 {
		compatible = "qcom,msm-cvp", "qcom,kalama-cvp-tvm";
		status = "ok";
	};
};
