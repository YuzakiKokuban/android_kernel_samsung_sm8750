// SPDX-License-Identifier: BSD-3-Clause
/*
 * Copyright (c) 2024 Qualcomm Innovation Center, Inc. All rights reserved.
 */

/dts-v1/;
/plugin/;

#include <dt-bindings/interrupt-controller/arm-gic.h>
#include <dt-bindings/soc/qcom,ipcc.h>
#include <dt-bindings/interconnect/qcom,kalama.h>
#include <dt-bindings/clock/qcom,videocc-kalama.h>
#include <dt-bindings/clock/qcom,gcc-kalama.h>
#include "trustedvm-kalama-eva.dtsi"

/ {
	model = "Qualcomm Technologies, Inc. Kalama QRD";
	compatible = "qcom,kalama-qrd", "qcom,kalama", "qcom,qrd";
	qcom,msm-id = <519 0x10000>, <536 0x10000>;
	qcom,board-id = <0x1000B 0>;
};
