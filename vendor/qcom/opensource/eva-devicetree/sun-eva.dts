// SPDX-License-Identifier: BSD-3-Clause
/*
 * Copyright (c) 2024 Qualcomm Innovation Center, Inc. All rights reserved.
 */

/dts-v1/;
/plugin/;

#include <dt-bindings/interrupt-controller/arm-gic.h>
#include <dt-bindings/soc/qcom,ipcc.h>
#include <dt-bindings/interconnect/qcom,sun.h>
#include <dt-bindings/clock/qcom,videocc-sun.h>
#include <dt-bindings/clock/qcom,gcc-sun.h>
#include <dt-bindings/clock/qcom,evacc-sun.h>
#include <dt-bindings/arm/msm/qti-smmu-proxy-dt-ids.h>
#include "sun-eva.dtsi"

/ {
	model = "Qualcomm Technologies, Inc. sun v1 SoC";
	compatible = "qcom,sun";
	qcom,msm-id = <618 0x10000>, <639 0x10000>, <0x100026a 0x10000>, <0x100027f 0x10000>;
	qcom,board-id = <0 0>, <15 0>, <8 0>, <11 0>, <1 0>;
};
