// SPDX-License-Identifier: BSD-3-Clause
/*
 * Copyright (c) 2024 Qualcomm Innovation Center, Inc. All rights reserved.
 */

#include "sun-eva.dtsi"

&msm_cvp {
	qcom,allowed-clock-rates = <350000000 400000000 450000000 500000000 550000000>;
	soc_ver = <0x20000>;
};

