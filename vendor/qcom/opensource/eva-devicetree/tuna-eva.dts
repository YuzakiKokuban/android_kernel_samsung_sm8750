// SPDX-License-Identifier: BSD-3-Clause
/*
 * Copyright (c) 2024 Qualcomm Innovation Center, Inc. All rights reserved.
 */

/dts-v1/;
/plugin/;

#include <dt-bindings/interrupt-controller/arm-gic.h>
#include <dt-bindings/soc/qcom,ipcc.h>
#include <dt-bindings/interconnect/qcom,tuna.h>
#include <dt-bindings/clock/qcom,videocc-tuna.h>
#include <dt-bindings/clock/qcom,gcc-tuna.h>
#include <dt-bindings/clock/qcom,evacc-tuna.h>
#include <dt-bindings/arm/msm/qti-smmu-proxy-dt-ids.h>
#include "tuna-eva.dtsi"

/ {
	model = "Qualcomm Technologies, Inc. Tuna";
	compatible = "qcom,tuna";
	qcom,msm-id = <655 0x10000>, <681 0x10000>;
	qcom,board-id = <0 0>, <15 0>;
};
