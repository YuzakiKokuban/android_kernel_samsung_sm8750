// SPDX-License-Identifier: BSD-3-Clause
/*
 * Copyright (c) 2024 Qualcomm Innovation Center, Inc. All rights reserved.
 */

#include "sun-vidc.dtsi"

/* sun V2-specific changes */
&msm_vidc {
	compatible = "qcom,sm8750-vidc-v2";
};

