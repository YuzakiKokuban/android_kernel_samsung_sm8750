// SPDX-License-Identifier: BSD-3-Clause
/*
 * Copyright (c) 2024 Qualcomm Innovation Center, Inc. All rights reserved.
 */

/dts-v1/;
/plugin/;

#include <dt-bindings/interrupt-controller/arm-gic.h>
#include <dt-bindings/clock/qcom,gcc-kalama.h>
#include <dt-bindings/interconnect/qcom,kalama.h>
#include <dt-bindings/clock/qcom,videocc-kalama.h>
#include "kalama-vidc-v2.dtsi"

/ {
	model = "Qualcomm Technologies, Inc. Kalama";
	compatible = "qcom,kalama";
	qcom,msm-id = <519 0x20000>, <536 0x20000>;
	qcom,board-id = <0 0>;
};
