// SPDX-License-Identifier: BSD-3-Clause
/*
 * Copyright (c) 2024 Qualcomm Innovation Center, Inc. All rights reserved.
 */
/dts-v1/;
/plugin/;

#include <dt-bindings/interrupt-controller/arm-gic.h>
#include <dt-bindings/clock/qcom,gcc-tuna.h>
#include <dt-bindings/interconnect/qcom,tuna.h>
#include <dt-bindings/clock/qcom,videocc-tuna.h>
#include "tuna-vidc.dtsi"

/ {
	model = "Qualcomm Technologies, Inc. tuna";
	compatible = "qcom,tuna";
	qcom,msm-id = <655 0x10000>;
	qcom,board-id = <0 0>;
};
