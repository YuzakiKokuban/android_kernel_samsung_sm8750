// SPDX-License-Identifier: BSD-3-Clause
/*
 * Copyright (c) 2024 Qualcomm Innovation Center, Inc. All rights reserved.
 */

/dts-v1/;
/plugin/;

#include <dt-bindings/interrupt-controller/arm-gic.h>
#include <dt-bindings/clock/qcom,gcc-waipio.h>
#include <dt-bindings/interconnect/qcom,waipio.h>
#include <dt-bindings/clock/qcom,videocc-waipio.h>
#include "waipio-vidc.dtsi"

/ {
	model = "Qualcomm Technologies, Inc. waipio v1 SoC";
	compatible = "qcom,waipio";
	qcom,msm-id = <457 0x10000>, <482 0x10000>,
			<457 0x20000>, <482 0x20000>;
	qcom,board-id = <0 0>;
};
