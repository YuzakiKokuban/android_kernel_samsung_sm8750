// SPDX-License-Identifier: BSD-3-Clause
/*
 * Copyright (c) 2024 Qualcomm Innovation Center, Inc. All rights reserved.
 */

/dts-v1/;
/plugin/;

#include <dt-bindings/interrupt-controller/arm-gic.h>
#include <dt-bindings/soc/qcom,ipcc.h>
#include <dt-bindings/interconnect/qcom,monaco.h>
#include <dt-bindings/clock/qcom,gcc-monaco.h>
#include <dt-bindings/clock/qcom,rpmcc.h>
#include "monaco-ipa.dtsi"

/ {
	model = "Qualcomm Technologies, Inc. Monaco";
	compatible = "qcom,monaco";
	qcom,msm-id = <486 0x10000>;
	qcom,board-id = <0 0>;
};
