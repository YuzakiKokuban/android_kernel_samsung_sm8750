// SPDX-License-Identifier: BSD-3-Clause
/*
 * Copyright (c) 2023-2024 Qualcomm Innovation Center, Inc. All rights reserved.
 */

/dts-v1/;
/plugin/;

#include <dt-bindings/interrupt-controller/arm-gic.h>
#include <dt-bindings/soc/qcom,ipcc.h>
#include <dt-bindings/interconnect/qcom,blair.h>
#include <dt-bindings/clock/qcom,gcc-blair.h>
#include <dt-bindings/clock/qcom,rpmcc.h>
#include "ipa_v4.dtsi"

/{
	model = "Qualcomm Technologies, Inc. Blair";
	compatible = "qcom,blair";
	qcom,msm-id = <507 0x10000>, <578 0x10000>;
	qcom,board-id = <0 0>;
};
