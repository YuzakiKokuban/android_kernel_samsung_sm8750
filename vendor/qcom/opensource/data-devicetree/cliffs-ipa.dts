// SPDX-License-Identifier: BSD-3-Clause
/*
 * Copyright (c) 2023-2024 Qualcomm Innovation Center, Inc. All rights reserved.
 */

/dts-v1/;
/plugin/;

#include <dt-bindings/interrupt-controller/arm-gic.h>
#include <dt-bindings/soc/qcom,ipcc.h>
#include <dt-bindings/interconnect/qcom,cliffs.h>
#include <dt-bindings/clock/qcom,gcc-cliffs.h>
#include <dt-bindings/clock/qcom,rpmh.h>
#include "cliffs-ipa.dtsi"

/{
	model = "Qualcomm Technologies, Inc. Cliffs";
	compatible = "qcom,cliffs";
	qcom,msm-id = <614 0x10000>, <632 0x10000>;
	qcom,board-id = <0 0>;
};
