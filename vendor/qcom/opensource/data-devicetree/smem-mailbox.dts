// SPDX-License-Identifier: BSD-3-Clause
/*
 * Copyright (c) 2024 Qualcomm Innovation Center, Inc. All rights reserved.
 */

/dts-v1/;
/plugin/;

#include <dt-bindings/interrupt-controller/arm-gic.h>
#include <dt-bindings/soc/qcom,ipcc.h>
#include <dt-bindings/clock/qcom,rpmh.h>
#include "smem-mailbox.dtsi"

/ {
	model = "Qualcomm Technologies, Inc. Sun SOC";
	compatible = "qcom,sun";
	qcom,msm-id = <618 0x10000>, <618 0x20000>,
		      <0x100026a 0x10000>, <0x100026a 0x20000>;
	qcom,board-id = <0 0>;
};
