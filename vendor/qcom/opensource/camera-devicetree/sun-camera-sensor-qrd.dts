// SPDX-License-Identifier: BSD-3-Clause
/*
 * Copyright (c) 2024 Qualcomm Innovation Center, Inc. All rights reserved.
 */

/dts-v1/;
/plugin/;

#include <dt-bindings/clock/qcom,gcc-sun.h>
#include <dt-bindings/clock/qcom,camcc-sun.h>
#include <dt-bindings/clock/qcom,cambistmclkcc-sun.h>
#include <dt-bindings/interconnect/qcom,sun.h>
#include <dt-bindings/interrupt-controller/arm-gic.h>
#include <dt-bindings/regulator/qcom,rpmh-regulator-levels.h>

#include "sun-camera-sensor-qrd.dtsi"
/ {
	model = "Qualcomm Technologies, Inc. Sun QRD";
	compatible = "qcom,sun-qrd", "qcom,sun", "qcom,qrd";
	qcom,msm-id = <618 0x10000>, <618 0x20000>, <639 0x10000>, <639 0x20000>,
		<0x100026a 0x10000>, <0x100026a 0x20000>,
		<0x100027f 0x10000>, <0x100027f 0x20000>;
	qcom,board-id = <0x1000B 0>, <0x1001F 0>, <0x2000B 0>, <0x3000B 0>;
};
