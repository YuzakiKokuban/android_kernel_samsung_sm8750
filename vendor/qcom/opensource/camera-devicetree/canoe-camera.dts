// SPDX-License-Identifier: BSD-3-Clause
/*
 * Copyright (c) 2024 Qualcomm Innovation Center, Inc. All rights reserved.
 */

/dts-v1/;
/plugin/;

#include <dt-bindings/clock/qcom,gcc-canoe.h>
#include <dt-bindings/clock/qcom,camcc-canoe.h>
#include <dt-bindings/interconnect/qcom,canoe.h>
#include <dt-bindings/interrupt-controller/arm-gic.h>
#include <dt-bindings/regulator/qcom,rpmh-regulator-levels.h>

#include "canoe-camera.dtsi"
/ {
	model = "Qualcomm Technologies, Inc. canoe SoC";
	compatible = "qcom,canoe";
	qcom,msm-id = <660 0x10000>;
	qcom,board-id = <0 0>;
};
