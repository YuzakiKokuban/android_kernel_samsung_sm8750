// SPDX-License-Identifier: BSD-3-Clause
/*
 * Copyright (c) 2024 Qualcomm Innovation Center, Inc. All rights reserved.
 */

/dts-v1/;
/plugin/;

#include <dt-bindings/clock/qcom,gcc-sun.h>
#include <dt-bindings/clock/qcom,camcc-sun.h>
#include <dt-bindings/clock/qcom,cambistmclkcc-sun.h>
#include <dt-bindings/interconnect/qcom,sun.h>
#include <dt-bindings/interrupt-controller/arm-gic.h>
#include <dt-bindings/regulator/qcom,rpmh-regulator-levels.h>

#include "sun-camera-sensor-mtp.dtsi"
/ {
	model = "Qualcomm Technologies, Inc. Sun MTP";
	compatible = "qcom,sun-mtp", "qcom,sun", "qcom,mtp";
	qcom,msm-id = <618 0x10000>, <618 0x20000>, <639 0x10000>, <639 0x20000>,
		<0x100026a 0x10000>, <0x100026a 0x20000>,
		<0x100027f 0x10000>, <0x100027f 0x20000>;
	qcom,board-id = <8 0>, <0x108 0>, <0x20008 0>, <0x30008 0>, <0x40008 0>, <0x40108 0>, <0x50008 0>, <0x60008 0>;
};
