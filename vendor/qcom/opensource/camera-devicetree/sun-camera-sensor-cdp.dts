// SPDX-License-Identifier: BSD-3-Clause
/*
 * Copyright (c) 2024 Qualcomm Innovation Center, Inc. All rights reserved.
 */

/dts-v1/;
/plugin/;

#include <dt-bindings/clock/qcom,gcc-sun.h>
#include <dt-bindings/clock/qcom,camcc-sun.h>
#include <dt-bindings/clock/qcom,cambistmclkcc-sun.h>
#include <dt-bindings/interconnect/qcom,sun.h>
#include <dt-bindings/interrupt-controller/arm-gic.h>
#include <dt-bindings/regulator/qcom,rpmh-regulator-levels.h>

#include "sun-camera-sensor-cdp.dtsi"
/ {
	model = "Qualcomm Technologies, Inc. Sun CDP/RCM";
	compatible = "qcom,sun-cdp", "qcom,sun", "qcom,cdp", "qcom,rcm", "qcom,sun-rcm";
	qcom,msm-id = <618 0x10000>, <618 0x20000>, <639 0x10000>, <639 0x20000>,
		<0x100026a 0x10000>, <0x100026a 0x20000>,
		<0x100027f 0x10000>, <0x100027f 0x20000>;
	qcom,board-id = <1 0>, <21 0>, <0x20001 0>, <0x30001 0>, <0x40001 0>, <0x50001 0>, <0x60001 0>, <0x30015 0>, <0x40015 0>, <0x20015 0>;
};
