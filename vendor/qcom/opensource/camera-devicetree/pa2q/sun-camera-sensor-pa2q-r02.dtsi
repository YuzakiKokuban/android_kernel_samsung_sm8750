#include "sun-camera-sensor-pa2q-r01.dtsi"

&sensor_rear_tele {

	pinctrl-0 = <&cam_sensor_mclk3_active &tele3xcam_rst_n_active &telecam_ldo_en_active>;
	pinctrl-1 = <&cam_sensor_mclk3_suspend &tele3xcam_rst_n_suspend &telecam_ldo_en_suspend>;

	gpios = <&tlmm 92 0>, <&pm8550ve_i_gpios 3 0>, <&pm8550ve_g_gpios 5 0>, <&tlmm 94 0>;
};
